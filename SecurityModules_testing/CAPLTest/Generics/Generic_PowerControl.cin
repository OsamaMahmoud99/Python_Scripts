/*@!Encoding:1252*/


variables
{
}

ftos (float number, char string[] )
{
    int temp1,temp2;
    char string_temp_1[10],string_temp_2[10];
    
    strncpy(string_temp_1," ",10);
    strncpy(string_temp_2," ",10);
    temp1=(int)number;
    temp2=(number- (float)temp1)*100;
    ltoa(temp1,string_temp_1,10);
    ltoa(temp2,string_temp_2,10);
    
    strncat(string,"",10);
    strncat(string,string_temp_1,10);
    strncat(string,".",10);
    strncat(string,string_temp_2,10);
}

void Power_Supply_Power_Off ()	
{
	
	
        //send the order to power supply
        sysSetVariableInt(sysvar::PowerSupplyControl::Power_supply_On,0);
        testWaitForTimeout(2000);  

}

void Power_Supply_Power_On ()	
{	
    
        //send the order to power supply
        sysSetVariableInt(sysvar::PowerSupplyControl::Power_supply_On,1); 
        testWaitForTimeout(1000); //This time is critical=1000ms
}	



void Power_Supply_Volt_Set_Absolute (float volt)	
{	
    //float wanted_volt;
    float read_volt_from_ecu;
    int   temp1,temp2;
    char  volt_temp_1[10],volt_temp_2[10];
    char  mes[40];
    char  mes2[120];
    int   Confirmation=0;
    
    Confirmation = 0;


 
    //checking if the connection is verified
    //if(sysGetVariableInt(sysvar::PowerSupplyControl::Power_Supply_connection_verified)==1)
    //{      
        //wanted_volt=volt;
        sysSetVariableFloat(sysvar::PowerSupplyControl::Power_supply_Volt_Float,volt);
        testWaitForTimeout(500);

        
        /* writing a comment to let the user know the volt value*/
        strncpy(volt_temp_1," ",10);
        strncpy(volt_temp_2," ",10);
        strncpy(mes2," ",120);

        ftos(volt,volt_temp_1);
        strncpy(mes2,"The power supply Volt changed to ",120);
        strncat(mes2,volt_temp_1,120);
        
        teststep("Power Supply",mes2);

   // }

    
}	

void PowerCycle ()	
{	

    ///////////////////////////////////////////////////////
    /*Please enter Code for specified platform, i.e setting of power mode etc.
    */
    ///////////////////////////////////////////////////////


    //////////////////////////////////////////////////////////////////////////////////////////////////////////////////
    Power_Supply_Power_Off();
    //////////////////////////////////////////////////////////////////////////////////////////////////////////////////
    

    ////////////////////////////////////////////////////////
    //The waiting time after the power is OFF
    TestWaitForTimeOut(1010);
    ////////////////////////////////////////////////////////


    ////////////////////////////////////////////////////////
    /*Please enter Code for specified platform, i.e setting of power mode etc.
    */
    ////////////////////////////////////////////////////////


    //////////////////////////////////////////////////////////////////////////////////////////////////////////////////
    Power_Supply_Power_On();
    //////////////////////////////////////////////////////////////////////////////////////////////////////////////////

    ////////////////////////////////////////////////////////
	/*Please enter Code for specified platform, i.e setting of power mode etc.
    */
    ////////////////////////////////////////////////////////
    

    ////////////////////////////////////////////////////////
    //The waiting time after the power is ON
    TestWaitForTimeOut(8010);
    ////////////////////////////////////////////////////////
}	



