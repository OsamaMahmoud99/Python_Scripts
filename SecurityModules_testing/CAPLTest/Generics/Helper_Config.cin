/*@!Encoding:1252*/
variables{
  char EcuName[100] = "DMSM";
  char diagTarget[200]="DMSM_0001_00000000_025";
  char busNameDiag[256]="PKM49_E1A_R1_CANFD3";
  
  /*TimeOut section*/
  int DiagRequestTimeOut = 2000;
  int TesterConfirmationTimeOut = 20000;
  int SwInitializationTimeOut = 30000;
}