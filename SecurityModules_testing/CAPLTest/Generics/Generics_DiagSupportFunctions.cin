/*@!Encoding:1252*/
includes{
  
}
variables{
  
  enum PowerControlRequest_t  {PowerOff = 0 , PowerOn = 1 , PowerReset = 3};
  int IsAutomaticSupplyUsed = 1;
  int ReadyToSendDiag = 1;
 int DONT_CARE = 0xFF;
int ReceiveResponse;
byte enable_ignoreResponsePending = 1;


}
 


int Helper_EvaluateDiagnosticResponse(diagRequest *request,diagResponse *response,int responseTimeout){
  int ResponseCode = 0;
  int returnValue;
  ResponseCode=0;
  returnValue=0;
  //recieve response
  switch (testWaitForDiagResponse(request,responseTimeout)) {
    case 1:
      // check whether positive,negative or No response.
      ResponseCode = diagGetLastResponseCode(request);
      returnValue=ResponseCode;
      switch (ResponseCode){
        case -1:
          testStepPass("Positive Response Received");
          TestReportWriteDiagResponse(request);
        break;
        case 0:
          testStepFail("No Response Received");
        break;
        default:
          Helper_ReportNegativeResponse(ResponseCode);
          TestReportWriteDiagResponse(request);
        break; 
      }
      Helper_ReportError(diagGetLastResponse(request,response));
      break; 
    case 0:
      testStepFail("Response Not Recieved - Timeout");
      return 0;
      break;
    default:
      testStepFail("Response Not Recieved - Internal Error");
      return 0;
      break;  
  }
  return returnValue;
}
//lookup tables for possible errors .. affects TestReport
void Helper_ReportError(int ErrorCode){
  
  switch (ErrorCode) {
    case 0:
      testStepPass("No Errors - Success!");
      break;
    case -100:
      testStepFail("The input provided on function call is not consistent or sufficient.");
      break;
    case -99:
      testStepFail("The object's response is pending, therefore cannot delete it.");
      break;
    case -98:
      testStepFail("Invalid diagnostic object handle encountered!");
      break;
    case -97:
      testStepFail("An operation on a parameter is not possible, because it cannot be found or is not accessible");
      break;
    case -96:
      testStepFail("Function not implemented yet.");
      break;
    case -95:
      testStepFail("An operation performed on the diagnostic objects contradicts the definitions in the diagnostic descriptions.");
      break;
    case -94:
      testStepFail("Diagnostics not initialized! A tester must call diagSetTarget().");
      break;
    case -93:
      testStepFail("The specified callback was not found.");
      break;
    case -92:
      testStepFail("There was an error on TP level.");
      break;
    case -91:
      testStepFail("Only one request/response can be sent at a time!");
      break;
    case -90:
      testStepFail("Test function outside TestCase, or Tester-only function called in ECU, or vice-versa.");
      break;
    case -89:
      testStepFail("No seed and key library was specified.");
      break;
    case -88:
      testStepFail("The Seed & Key library did not contain a matching Seed & Key function.");
      break;
    case -87:
      testStepFail("The seed and key library couldn't be loaded.");
      break;
    case -86:
      testStepFail("The buffer was too small.");
      break;
    case -85:
      testStepFail("The seed array size is too large.");
      break;
    case -84:
      testStepFail("The security level is invalid.");
      break;
    case -83:
      testStepFail("The variant is invalid.");
      break;
    case -82:
      testStepFail("An unspecified error occurred.");
      break;
    case -81:
      testStepFail("The function cannot perform the action because of wrong HW.");
      break;
    case -80:
      testStepFail("No matching request was found to perform the action.");
      break;
    case -79:
      testStepFail("No diagnostic channel found.");
      break;
    case -78:
      testStepFail("No suitable class or request was found.");
      break;
    case -77:
      testStepFail("A time out happened.");
      break;
    case -76:
      testStepFail("Transmission failed.");
      break;
    case -75:
      testStepFail("The class was not found in the diagnostic description.");
      break;
    case -74:
      testStepFail("Creation of the PDU bytes for a diagnostic object failed! Parameters without defaults may have to be set.");
      break;
    case -73:
      testStepFail("During processing a negative response was received.");
      break;
    case -72:
      testStepFail("No key could be calculated.");
      break;
    case -71:
      testStepFail("The key was not accepted.");
      break;
    case -70:
      testStepFail("The diagnostic object is too small.");
      break;
    default:
      
      break;
  }
}
void Helper_ReportNegativeResponse(int ResponseCode){
  switch (ResponseCode) {
    case 0x10:
      testStep("Helper_ReportNegativeResponse","Negative Response - General Reject.");
      break;
    case 0x11:
      testStep("Helper_ReportNegativeResponse","Negative Response - Service Not Supported.");
      break;
    case 0x12:
      testStep("Helper_ReportNegativeResponse","Negative Response - Subfunction Not Supported.");
      break;
    case 0x13:
      testStep("Helper_ReportNegativeResponse","Negative Response - Incorrect Message length or Invalid Format.");
      break;
    case 0x14:
      testStep("Helper_ReportNegativeResponse","Negative Response - Response too long.");
      break;
    case 0x21:
      testStep("Helper_ReportNegativeResponse","Negative Response - Busy Repeat Request.");
      break;
    case 0x22:
      testStep("Helper_ReportNegativeResponse","Negative Response - Conditions Not Correct.");
      break;
    case 0x23:
      testStep("Helper_ReportNegativeResponse","Negative Response - Reserved by Document.");
      break;
    case 0x25:
      testStep("Helper_ReportNegativeResponse","Negative Response - No Response from subnet component.");
      break;
    case 0x24:
      testStep("Helper_ReportNegativeResponse","Negative Response - Request sequence error.");
      break;
    case 0x26:
      testStep("Helper_ReportNegativeResponse","Negative Response - Failure Prevents Excution of Requested Action.");
      break;
    case 0x31:
      testStep("Helper_ReportNegativeResponse","Negative Response - Request out of Range.");
      break;
    case 0x33:
      testStep("Helper_ReportNegativeResponse","Negative Response - Security access denied.");
      break;
    case 0x35:
      testStep("Helper_ReportNegativeResponse","Negative Response - Invalid Key.");
      break;
    case 0x36:
      testStep("Helper_ReportNegativeResponse","Negative Response - Exceed number of attempts.");
      break;
    case 0x37:
      testStep("Helper_ReportNegativeResponse","Negative Response - Required time delay not expired.");
      break;
    case 0x39:
      testStep("Helper_ReportNegativeResponse","Negative Response - Secured Mode Requested.");
      break;
    case 0x70:
      testStep("Helper_ReportNegativeResponse","Negative Response - Upload/download not accepted.");
      break;
    case 0x71:
      testStep("Helper_ReportNegativeResponse","Negative Response - Data Transfer Suspended.");
      break;
    case 0x72:
      testStep("Helper_ReportNegativeResponse","Negative Response - General programming failure.");
      break;
    case 0x73:
      testStep("Helper_ReportNegativeResponse","Negative Response - Wrong block sequence counter.");
      break;
    case 0x78:
      testStep("Helper_ReportNegativeResponse","Negative Response - Request Correctly Received-Response Pending.");
      break;
    case 0x7E:
      testStep("Helper_ReportNegativeResponse","Negative Response - Subfunction not supported in active session.");
      break;
    case 0x7F:
      testStep("Helper_ReportNegativeResponse","Negative Response - Service not supported in active session.");
      break;
    case 0x81:
      testStep("Helper_ReportNegativeResponse","Negative Response - RPM too high.");
      break;
    case 0x82:
      testStep("Helper_ReportNegativeResponse","Negative Response - RPM too low.");
      break;
    case 0x83:
      testStep("Helper_ReportNegativeResponse","Negative Response - Engine is running.");
      break;
    case 0x84:
      testStep("Helper_ReportNegativeResponse","Negative Response - Engine is not running.");
      break;
    case 0x85:
      testStep("Helper_ReportNegativeResponse","Negative Response - Engine Run Time too low.");
      break;
    case 0x86:
      testStep("Helper_ReportNegativeResponse","Negative Response - Temperature too high.");
      break;
    case 0x87:
      testStep("Helper_ReportNegativeResponse","Negative Response - Temperature too low.");
      break;
    case 0x88:
      testStep("Helper_ReportNegativeResponse","Negative Response - Vehicle speed too high.");
      break;
    case 0x89:
      testStep("Helper_ReportNegativeResponse","Negative Response - Vehicle speed too low.");
      break;
    case 0x8A:
      testStep("Helper_ReportNegativeResponse","Negative Response - Throttle/pedal too high.");
      break;
    case 0x8B:
      testStep("Helper_ReportNegativeResponse","Negative Response - Throttle/pedal too low.");
      break;
    case 0x8C:
      testStep("Helper_ReportNegativeResponse","Negative Response - Transmission range not in neutral.");
      break;
    case 0x8D:
      testStep("Helper_ReportNegativeResponse","Negative Response - Transmission range not in gear.");
      break;
    case 0x8F:
      testStep("Helper_ReportNegativeResponse","Negative Response - Brake switch(es) not closed (brake pedal not pressed or not applied).");
      break;
    case 0x90:
      testStep("Helper_ReportNegativeResponse","Negative Response - Shifter lever not in park.");
      break;
    case 0x91:
      testStep("Helper_ReportNegativeResponse","Negative Response - Torque converter clutch locked.");
      break;
    case 0x92:
      testStep("Helper_ReportNegativeResponse","Negative Response - Voltage too high.");
      break; 
    case 0x93:
      testStep("Helper_ReportNegativeResponse","Negative Response - Voltage too low.");
      break;
    case 0xF0:
      testStep("Helper_ReportNegativeResponse","Negative Response - Functionality deactivated by variant coding.");
      break;
    case 0x00:
      testStep("Helper_ReportNegativeResponse","Positive response received!");
      break;
    default:
      
      break;
  }
}
int Helper_ReportTesterAction(char text[], int TimeOut){    //Tester Dependent helper Functions
  int ret = -1;
  switch (testWaitForTesterConfirmation(text,TimeOut)) {
    case 2:
      testStepWarning("The Tester Clicked No.");
      break;
    case 1:
      ret = 1; 
      testStepPass("The Tester Clicked Yes.");
      break;
    case 0:
      testStepFail("Timeout Occured.");
      break;
    case -1:
      testStepFail("General Error.");
      break;
    case -2:
      testStepFail("Constraint Occured.");
      break;
  } 
  return ret;
}  


