/*@!Encoding:1252*/

/*@!Encoding:1252*/
/*@!Encoding:1252*/
includes{
  
}
variables{
  
  
  char testInfoBuffer[2000] = "";
  char testActionBuffer[30000] = "";
  char testExpectationBuffer[30000] = "";
  char testObtainedBuffer[30000] = "";
  int ActionCounter = 0;
  int ExpectationCounter = 0;
  char ExpectationCounter_String[1000]="";
  int ReactionCounter = 0;
  char ReactionCounter_String[1000]="";
  int testStatus = 0;
  
	enum TestPriority
  {
    BasicTest=0, 
    SafetyCriticalTest,
    FullTest,
    RobustnessTest
  } ;
	enum TestMethod
  {
    Automatic=0, 
    Manual
  } ;
  enum TestEnvironement
  {
    HIL=0,
    SIL
  };
  enum TestDerivationMethod
  {
    RequirementBased=0,
    CustomerAcceptanceTest,
    ExperienceBased    
  };
  enum TestingTechnique
  {
    BoundaryValueAnalysis=0,
    EquivalencePartitioning,
    DecisionTables,
    StateTransition,
    CombinatorialTesting,
    UseCaseTesting    
  };
}
  

///////////////////////////////////////Diag TP Functions///////////////////////////////////////
TestCaseHeader(char TestID [],
char TestTitle [], 
char TestDescription [], 
char Requirements[], 
char TestExecutionDate [], 
char TestEngineer [], 
char SwVersion [], 
enum TestPriority testPriority, 
enum TestMethod testMethod, 
enum TestEnvironement testEnvironement, 
enum TestDerivationMethod testDerivationMethod, 
enum TestingTechnique testingTechnique)
{
  char buffer[500]="";
  testCaseTitle(TestID, TestTitle);
  testCaseDescription(TestDescription);
  testReportAddMiscInfo("Requirements", Requirements);
  testReportAddMiscInfo("TestExecutionDate",TestExecutionDate);
  TestReportAddEngineerInfo("Test Engineer", TestEngineer);
  testReportAddMiscInfo("SwVersion",SwVersion);
  testReportAddMiscInfoBlock("Test Case Properties");
  snprintf(buffer, elcount(buffer),testPriority.Name());
  testReportAddMiscInfo("TestPriority",buffer);
  snprintf(buffer, elcount(buffer),testMethod.Name());
  testReportAddMiscInfo("TestMethod",buffer);
  snprintf(buffer, elcount(buffer),testEnvironement.Name());
  testReportAddMiscInfo("TestEnvironement",buffer);
  snprintf(buffer, elcount(buffer),testDerivationMethod.Name());
  testReportAddMiscInfo("TestDerivationMethod",buffer);
  snprintf(buffer, elcount(buffer),testingTechnique.Name());
  testReportAddMiscInfo("TestingTechnique",buffer);
}
void TestAction(char ActionText[])
{
  char buffer[10000];
  ActionCounter = ActionCounter + 1;
  ExpectationCounter=1;
  ReactionCounter=1;
  snprintf(buffer,elcount(buffer),"%d",ActionCounter);
  testStep(buffer,ActionText);
 
}

void TestExpectation(char ExpectationText[])
{
  char buffer[10000];
  snprintf(buffer,elcount(buffer),"%d",ActionCounter);
  testStep(buffer,ExpectationText);

}


