/*@!Encoding:1252*/
includes
{
}

variables
{
  int Confirmation;
  int NMCount = 0, AppCount = 0;
  int check;

  // measure at which time the message recieved
  float timer_NM[22];
  int timer_NMCount = 0;
  float timer_APP[10];
  int timer_APPCount = 0;
  char string[400]="";
}
  



Start_Frame(char msg1[])
{
  int Confirmation=-1;
  
  snprintf(string, 200,"Start Sending Message %s", msg1);
  TestAction(string);
  Confirmation=testEnableMsg (msg1);
  if(Confirmation != -1)
	{
		TestStepPass("Frame started");
	}
	else
	{
		TestStepFail("Frame Not started");
	}
}


Stop_Frame(char msg1[])
{
  int Confirmation=-1;
  snprintf(string, 200,"Stop Sending Message %s", msg1);
  TestAction(string);
  Confirmation=TestDisableMsg (msg1);
  if(Confirmation != -1)
	{
		TestStepPass("Frame stopped");
	}
	else
	{
		TestStepFail("Frame Not stopped");
	}
}

Start_all_Frames_from_Node(char Node[])
{
  int Confirmation=-1;
  
  snprintf(string, 200,"Start Sending Messages from Node: [%s]", Node);
  TestAction(string);
  Confirmation=TestEnableMsgAllTx(Node);
  if(Confirmation != -1)
	{
		TestStepPass("Frames started");
	}
	else
	{
		TestStepFail("Frames Not started");
	}
}

Stop_all_Frames_from_Node(char Node[])
{
  int Confirmation=-1;
  
  snprintf(string, 200,"Stop Sending Messages from Node: [%s]", Node);
  TestAction(string);
  Confirmation=TestDisableMsgAllTx(Node);
  if(Confirmation != -1)
	{
		TestStepPass("Frames started");
	}
	else
	{
		TestStepFail("Frames Not started");
	}
  //testWaitForTimeout(1000);
}

void Start_all_Frames(){
  TestAction("Start Sending All Frames");
  Start_all_Frames_from_Node("Engine");//Nodes to be updated according project DB
  Start_all_Frames_from_Node("Trans");//Nodes to be updated according project DB

}

void Stop_all_Frames(){
  TestAction("Stop All Frames");
  Stop_all_Frames_from_Node("Engine");//Nodes to be updated according project DB
  Stop_all_Frames_from_Node("Trans");//Nodes to be updated according project DB

}

void check_BUS_Load_more_than(float usage_percentage,int CAN_Channel){
  int actual_value;
  snprintf(string,400,"Check That Bus Load of channel [%d] is more than [%f]",CAN_Channel,usage_percentage);
  TestExpectation(string);
  actual_value=canGetBusLoad(CAN_Channel);
  if(actual_value>usage_percentage){
    snprintf(string,400,"The Bus Load of CAN BUS channel [%d] is [%d] which is more than [%d]",CAN_Channel,actual_value,usage_percentage);
    testStepPass(string);
  }
  else{
    snprintf(string,400,"The Bus Load of CAN BUS channel [%d] is [%d] which is less than [%d]",CAN_Channel,actual_value,usage_percentage);
    testStepFail(string);
  }
  
}

void check_BUS_Load_less_than(int usage_percentage,int CAN_Channel){
  int actual_value;
  snprintf(string,400,"Check That Bus Load of channel [%d] is more than [%d]",CAN_Channel,usage_percentage);
  TestExpectation(string);
  actual_value=canGetBusLoad(CAN_Channel);
  if(actual_value<usage_percentage){
    snprintf(string,400,"The Bus Load of CAN BUS channel [%d] is [%d] which is less than [%d]",CAN_Channel,actual_value,usage_percentage);
    testStepPass(string);
  }
  else{
    snprintf(string,400,"The Bus Load of CAN BUS channel [%d] is [%d] which is more than [%d]",CAN_Channel,actual_value,usage_percentage);
    testStepFail(string);
  }
  
}
//////////////////////////////////// For CAN Bus ////////////////////////////////////
Check_Msg_Received(char msg1[],int window)
{   
    dword a;
    a=getMessageID(msg1);
  	Confirmation = -1;
	  Confirmation = TestWaitForMessage(a, window);
    snprintf(string,400,"Check Message %s Recieved within %d ms",msg1,window);
    TestExpectation(string);

	
	if(Confirmation == 1)
	{
		TestStepPass("Frame Recieved");
	}
	else
	{
		TestStepFail("Frame Not Received");
	}
}

Check_Msg_NOT_Received(char msg1[],int window)
{
  dword a;
  a=getMessageID(msg1);
  Confirmation = -1;
  Confirmation = TestWaitForMessage(a,window);
  snprintf(string,400,"Check Message %s NOT Recieved within %d ms",msg1,window);
  TestExpectation(string);

	
	if(Confirmation == 1) 
	{
		TestStepFail("Frame Received");	
	}
	else
	{
	  TestStepPass("Frame not Recieved");
 	}
  
}

////////////////////////////////////////////////////////////////////////////////////////
//////////////////////////////////// For CAN-FD Bus ////////////////////////////////////
Check_PDU_Received(char msg1[],int window)
{   
    dword a;
//    a=getMessageID(msg1);
  	Confirmation = -1;
	  Confirmation = TestWaitForPDU(msg1,0, window);
    snprintf(string,400,"Check Message %s Recieved within %d ms",msg1,window);
    TestExpectation(string);

	
	if(Confirmation == 1)
	{
		TestStepPass("Frame Recieved");
	}
	else
	{
		TestStepFail("Frame Not Received");
	}
}

Check_PDU_NOT_Received(char msg1[],int window)
{
  dword a;
  //a=getMessageID(msg1);
  Confirmation = -1;
  Confirmation = TestWaitForPDU(msg1,0,window);
  snprintf(string,400,"Check Message %s NOT Recieved within %d ms",msg1,window);
  TestExpectation(string);

	
	if(Confirmation != 0) 
	{
		TestStepFail("Check_PDU_NOT_Received","Frame Received or General error %d",Confirmation);	
	}
	else
	{
	  TestStepPass("Frame not Recieved");
 	}
  
}



setSignalwithValue(Signal *buf,double b,char meaning[])
{
  snprintf(string,400,"Set the value of signal %s with value %f ,which means %s",buf.name,b,meaning);
  TestAction(string);
  setSignal(buf,b); 
}

checkDLCMessage(message* msg1,int expectedDLC){
	long currentDLC;
  char container[800];
  currentDLC = canGetDataLength(msg1);
  snprintf(container,800,"Check DLC of message [%s] is: [%d] ",msg1.name,expectedDLC);
  TestExpectation(container);
  if (currentDLC == expectedDLC){
    testStepPass("CheckSignal","Expected = %d,Obtained Right value = %d",expectedDLC,currentDLC);
    snprintf(container,800,"CheckSignal","Expected = %d,Obtained Right value = %d",expectedDLC,currentDLC);
    }
  else{
    snprintf(container,800,"CheckSignal","Expected = %d,Obtained Right value = %d",expectedDLC,currentDLC);
    testStepFail("CheckSignal","Expected = %d,Obtained Right value = %d",expectedDLC,currentDLC);
  }
}


//////////////////////////////////////// Test Service Library based functions //////////////////////////////////////// 
//////////////////////////////////////// add Message periodicity as the check condition _ here we added minimum and maximum periodicity value ////////////////////////////////////////
check_msg_cycle_time (dbMsg* msg, int min_periodicity,int max_periodicity, int Timeout){
  //canGetDataLength(msg);
	char buffer[300];
	snprintf(buffer,300,"Check message [%s] is received cyclically with average periodicity [%d] ms for %d ms",DBLookup(msg).Name,min_periodicity/2+max_periodicity/2,Timeout);
	TestAction(buffer);
	check = ChkStart_MsgAbsCycleTimeViolation (msg,min_periodicity,max_periodicity);
	TestAddCondition(check);
	TestWaitForTimeout(Timeout);
	TestRemoveCondition(check);
}
check_msg_cycle_time (long msgID, int min_periodicity,int max_periodicity, int Timeout){
  //canGetDataLength(msg);
	char buffer[300];
	snprintf(buffer,300,"Check message [%s] is received cyclically with average periodicity [%d] ms for %d ms",msgID,min_periodicity/2+max_periodicity/2,Timeout);
	TestAction(buffer);
	check = ChkStart_MsgAbsCycleTimeViolation (msgID,min_periodicity,max_periodicity);
	TestAddCondition(check);
	TestWaitForTimeout(Timeout);
	TestRemoveCondition(check);
}
//////////////////////////////////////// add Message occurance count as the check condition _ ////////////////////////////////////////
//////////////////////////////////////// here we added the count that should be met within specific timeout before removing TestCondition ////////////////////////////////////////
check_msg_max_occurrence (dbMsg* msg, int max_count,int Timeout){
	// checks that the message is sent less than or equal to max_count
	check = ChkStart_MsgOccurrenceCount (msg,max_count);
	TestAddCondition(check);
	// sequence of different actions and waiting conditions
	TestWaitForTimeout(Timeout);
	TestRemoveCondition(check);
}



//////////////////////////////////////// add SignalValueChange as the check condition _ ////////////////////////////////////////
//////////////////////////////////////// here we are cheching if physical value of Signal or system variable will be updated within timeout ////////////////////////////////////////
check_signal_value_change (signal *buffer,int Timeout){
  char buffer2[300];
  snprintf(buffer2,300,"Check if the value of signal [%s] is changed within [%d] ms",buffer.name,Timeout);
  TestAction(buffer2);
  write("%s",buffer2);
	check = ChkStart_SignalValueChange (buffer);
	TestAddCondition(check);
	TestWaitForTimeout(Timeout);
	TestRemoveCondition(check);
}

check_system_variable_value_change (sysvar *buffer,int Timeout){
  char buffer2[300];
  snprintf(buffer2,300,"Check if the value of system variable [%s] is changed within [%d] ms",buffer.name,Timeout);
  TestAction(buffer2);
  write("%s",buffer2);
	check = ChkStart_SignalValueChange (buffer);
	TestAddCondition(check);
	TestWaitForTimeout(Timeout);
	TestRemoveCondition(check);
}

//////////////////////////////////////// here we are cheching if physical value of Signal or system variable equals specific value  ////////////////////////////////////////
//////////////////////////////////////// Check current/immediate value of the signal//////////////////////////////////////// 
Check_SignalWithValue(signal *buffer,int a, char meaning[])
{
int result=0;
snprintf(string,400,"Check Signal %s value = %d",buffer.name,a);
TestExpectation(string);

result = getSignal(buffer);
if(result == a){
  snprintf(string,400,"CheckSignal:  %s ,Expected = %d,Obtained Right value = %d, which means %s",buffer.name,a,result,meaning);
  TestStepPass("Check_SignalWithValue",string);

}
else{
  snprintf(string,400,"CheckSignal:  %s ,Expected = %d,Obtained Wrong- value = %d, which means %s",buffer.name,a,result,meaning);
  testStepfail("Check_SignalWithValue",string);
}
}
//////////////////////////////////////// Check signal value matches expected value within timeout /////////////////////////////////// 
Check_SignalWithValuewithin(signal *buffer,int value, int timeout, char comment[])
{
  int result=0;
  dword index = 0;
  int obtained = 0;
  char container[800];
  result = TestJoinSignalMatch(buffer,value);
  index = TestWaitForAllJoinedEvents(timeout);
  obtained =  getSignal(buffer);
  snprintf(container,800,"Check value of: [%s]",buffer.name);
  TestAction(container);
  snprintf(container,800,"Check value of: [%s] is equal to: [%d] which means [%s]",buffer.name,value,comment);
  write(container);
  TestExpectation(container);
  if(index > 0)
  {
	testStepPass("CheckSignal"," Signal %s ,Expected = %d,Obtained Right value = %d",buffer.name,value,obtained);

  }
  else
  {
    testStepfail("CheckSignal"," Signal %s ,Expected = %d,Obtained Wrong- value = %d",buffer.name,value,obtained);

  }
}

//////////////////////////////////////// Check current/immediate value of the system variable//////////////////////////////////////// 
Check_SystemVariableWithValue(sysvarInt *buffer,int a, char meaning[])
{
  int result=0;
  snprintf(string,400,"Check sysVariable %s value = %d",buffer.name,a);
  TestExpectation(string);
  result = sysGetVariableInt(buffer);
  if(result == a)
  { 
    snprintf(string,400,"CheckSsysVariable:  %s ,Expected = %d,Obtained Right value = %d, which means %s",buffer.name,a,result,meaning);
    TestStepPass("Check_SystemVariableWithValue",string);
  }
  else
  {
    snprintf(string,400,"ChecksysVariable:  %s ,Expected = %d,Obtained Wrong- value = %d, which means %s",buffer.name,a,result,meaning);
    testStepfail("Check_SystemVariableWithValue",string);
  }
}
//////////////////////////////////////// Check system variable value matches expected value within timeout /////////////////////////////////// 
Check_SystemVariableWithValuewithin(sysvarInt *buffer,int value, int timeout, char comment[])
{
  int result=0;
  dword index = 0;
  int obtained = 0;
  char container[800];
  result = TestJoinSignalMatch(buffer,value);
  index = TestWaitForAllJoinedEvents(timeout);
  obtained =  sysGetVariableInt(buffer);
  snprintf(container,800,"Check value of: [%s]",buffer.name);
  TestAction(container);
  snprintf(container,800,"Check value of: [%s] is equal to: [%d] which means [%s]",buffer.name,value,comment);
  write(container);
  TestExpectation(container);
  if(index > 0)
  {
	testStepPass("Check_SystemVariableWithValuewithin"," sysVariable %s ,Expected = %d,Obtained Right value = %d",buffer.name,value,obtained);

  }
  else
  {
    testStepfail("Check_SystemVariableWithValuewithin"," sysVariable %s ,Expected = %d,Obtained Wrong- value = %d",buffer.name,value,obtained);
	
  }
}
