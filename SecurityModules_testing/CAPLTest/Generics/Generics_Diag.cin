/*@!Encoding:1252*/

/*@!Encoding:1252*/
/*@!Encoding:1252*/
includes{
  
  #include "Generics_DiagSupportFunctions.cin"
}
variables{
	byte Actual_Resp[480];

  
  char DiagTarget_FS  [100] = "BV_DoorElectDriveSideUDS_FS"; 
  char DiagTarget_BFS  [100] = "BV_DoorElectDriveSideUDS_BFS";
  char DiagTarget_HFS  [100] = "BV_DoorElectDriveSideUDS_HFS";
  char DiagTarget_HBFS  [100] = "BV_DoorElectDriveSideUDS_HBFS";
  
  diagRequest  BV_DoorElectDriveSideUDS_FS.* Request_FS; diagResponse  BV_DoorElectDriveSideUDS_FS.* Response_FS;
  diagRequest  BV_DoorElectDriveSideUDS_BFS.* Request_BFS; diagResponse  BV_DoorElectDriveSideUDS_BFS.* Response_BFS;
  diagRequest  BV_DoorElectDriveSideUDS_HFS.* Request_HFS; diagResponse  BV_DoorElectDriveSideUDS_HFS.* Response_HFS;
  diagRequest  BV_DoorElectDriveSideUDS_HBFS.* Request_HBFS; diagResponse  BV_DoorElectDriveSideUDS_HBFS.* Response_HBFS;
	
	message 0x6F1 Diag_Tester;
  message 0x606 Diag_Response;
  int DLC = 0x08;
  char BufferString[1000];
  int i;
  int Response_Counter = 0;
}
  

void DiagInit()
{
  
  Variant_diagSetTarget();
}


void Variant_diagSetTarget()
{
  int value;
  value = sysGetVariableInt(sysvar::Variant);
  if(value == variant_FS)
  {
    diagSetTarget(DiagTarget_FS);
  }
  else if(value == variant_BFS)
  {
    diagSetTarget(DiagTarget_BFS);
  }
  else if(value == variant_HFS)
  {
    diagSetTarget(DiagTarget_HFS);
  }
  else if(value == variant_HBFS)
  {
    diagSetTarget(DiagTarget_HBFS);
  }
   
}
///////////////////////////////////////Diag TP Layer Functions///////////////////////////////////////

SendDiagFrame_TP (byte arg1, byte arg2, byte arg3, byte arg4, byte arg5, byte arg6, byte arg7, byte arg8,char Comment[])
{
  Diag_Tester.DLC = DLC;
  Diag_Tester.Byte(0) = arg1;
  Diag_Tester.Byte(1) = arg2;
  Diag_Tester.Byte(2) = arg3;
  Diag_Tester.Byte(3) = arg4;
  Diag_Tester.Byte(4) = arg5;
  Diag_Tester.Byte(5) = arg6;
  Diag_Tester.Byte(6) = arg7;
  Diag_Tester.Byte(7) = arg8;
  TestStepPass("Send Diag frame:"," %02X %02X %02X %02X %02X %02X %02X %02X",arg1, arg2, arg3,arg4,arg5,arg6,arg7,arg8);
  output(Diag_Tester);

}

CheckDiagresponse8 (dWord window, int arg1, int arg2, int arg3, int arg4, int arg5, int arg6, int arg7, int arg8)
{
 
 int count = 0;	//counter to change the window (timeout) in case of pending request

 	do
 	{
 	  Confirmation = 0;
 	  Confirmation = TestWaitForMessage(0x606, window);
    //write("Message received");
 	if(count == 1)
 	window = 5100;
 	if(Confirmation == 0) 
 	{
 	  TestStepFail("CheckDiagresponse8", "Failure No response message on CheckDiagresponse8 within the check window %d expected %02X %02X %02X %02X %02X %02X %02X %02X", window, arg1, arg2, arg3,arg4,arg5,arg6,arg7,arg8);
     }
       TestGetWaitEventMsgData(Diag_Response);
 	count =1;
  }while((enable_ignoreResponsePending != 0) && (Diag_Response.Byte(1) == 0x7F) && (Diag_Response.Byte(3) == 0x78));
   
   if(Confirmation == 1) 
   {
     //write("Response received!");
     if((((Diag_Response.Byte(0)==arg1)||(arg1==DONT_CARE))&&
       ((Diag_Response.Byte(1)==arg2)||(arg2==DONT_CARE))&&
       ((Diag_Response.Byte(2)==arg3)||(arg3==DONT_CARE))&&
       ((Diag_Response.Byte(3)==arg4)||(arg4==DONT_CARE))&&
       ((Diag_Response.Byte(4)==arg5)||(arg5==DONT_CARE))&&
       ((Diag_Response.Byte(5)==arg6)||(arg6==DONT_CARE))&&
       ((Diag_Response.Byte(6)==arg7)||(arg7==DONT_CARE))&&
       ((Diag_Response.Byte(7)==arg8)||(arg8==DONT_CARE)))&&
         Diag_Response.dlc == 8
      )
       TestStepPass("CheckDiagresponse8","CheckDiagresponse8 OK observed %02X %02X %02X %02X %02X %02X %02X %02X expected %02X %02X %02X %02X %02X %02X %02X %02X", Diag_Response.Byte(0), Diag_Response.Byte(1), Diag_Response.Byte(2), Diag_Response.Byte(3),Diag_Response.Byte(4), Diag_Response.Byte(5), Diag_Response.Byte(6) ,Diag_Response.Byte(7), arg1, arg2, arg3,arg4,arg5,arg6,arg7,arg8);
       else
       TestStepFail("CheckDiagresponse8","Wrong check values %02X %02X %02X %02X %02X %02X %02X %02X and DLC = %d and expected %02X %02X %02X %02X %02X %02X %02X %02X and DLC = 8",Diag_Response.Byte(0), Diag_Response.Byte(1), Diag_Response.Byte(2), Diag_Response.Byte(3),Diag_Response.Byte(4), Diag_Response.Byte(5), Diag_Response.Byte(6) ,Diag_Response.Byte(7),Diag_Response.DLC, arg1, arg2, arg3,arg4,arg5,arg6,arg7,arg8);
  
   }
//  testWaitForTimeout(2000);
}

///////////////////////////////////////Diag Application Layer Functions///////////////////////////////////////

void Variant_Helper_ReportError_Request(byte req[] , int RequestLength)
{
  int value;
  int sendTimeout=1000;
  
  value = sysGetVariableInt(sysvar::Variant);
  
  if(value == variant_FS)
  {
      //write("FSSSSSSSSSSSSSS");
      Helper_ReportError(diagResize(Request_FS, RequestLength));
      Helper_ReportError(Request_FS.SetPrimitiveData(req,RequestLength)); //elcount(Incase known request from odx/cdd)
      Helper_ReportError(Request_FS.SendRequest()); 
      switch (testWaitForDiagRequestSent(Request_FS,sendTimeout)){
      case 1:      
        testStepPass("Request Sent");
        break;
      case 0:
        testStepFail("Request Not Sent - Timeout");
        break;
      default:
        testStepFail("Request Not Sent - Internal Error");
        break;
      }
  }
  else if(value == variant_BFS)
  {
      Helper_ReportError(diagResize(Request_BFS, RequestLength));
      Helper_ReportError(Request_BFS.SetPrimitiveData(req,RequestLength)); //elcount(Incase known request from odx/cdd)
      Helper_ReportError(Request_BFS.SendRequest()); 
      switch (testWaitForDiagRequestSent(Request_BFS,sendTimeout)){
      case 1:      
        testStepPass("Request Sent");
        break;
      case 0:
        testStepFail("Request Not Sent - Timeout");
        break;
      default:
        testStepFail("Request Not Sent - Internal Error");
        break;
      }
  }
  else if(value == variant_HFS)
  {
      Helper_ReportError(diagResize(Request_HFS, RequestLength));
      Helper_ReportError(Request_HFS.SetPrimitiveData(req,RequestLength)); //elcount(Incase known request from odx/cdd)
      Helper_ReportError(Request_HFS.SendRequest()); 
      switch (testWaitForDiagRequestSent(Request_HFS,sendTimeout)){
      case 1:      
        testStepPass("Request Sent");
        break;
      case 0:
        testStepFail("Request Not Sent - Timeout");
        break;
      default:
        testStepFail("Request Not Sent - Internal Error");
        break;
      }
  }
  else if(value == variant_HBFS)
  {
      Helper_ReportError(diagResize(Request_HBFS, RequestLength));
      Helper_ReportError(Request_HBFS.SetPrimitiveData(req,RequestLength)); //elcount(Incase known request from odx/cdd)
      Helper_ReportError(Request_HBFS.SendRequest()); 
      switch (testWaitForDiagRequestSent(Request_HBFS,sendTimeout)){
      case 1:      
        testStepPass("Request Sent");
        break;
      case 0:
        testStepFail("Request Not Sent - Timeout");
        break;
      default:
        testStepFail("Request Not Sent - Internal Error");
        break;
      }
    
  }

}
void sendDiagnosticsRequest(char RequestString[],char meaning[]){
  byte req[400];
  int RequestLength;
  int sendTimeout=1000;
  RequestLength = Convert_String_To_Hex(RequestString,req);
  
  Variant_diagSetTarget();
  
  snprintf(BufferString,400,"Send Diagnostics Request : %s ,which means %s",RequestString,meaning);
  TestAction(BufferString);
  
  Variant_Helper_ReportError_Request(req , RequestLength);
}

void sendDiagnosticsRequest_array(Byte  req[] , int RequestLength){
  
  int sendTimeout=1000;
  char expected_req_string[1000]="";
  char string_expected[1000]="";
  
   Variant_diagSetTarget();
  

  for(i=0; i<RequestLength; i++)
  {
     snprintf(expected_req_string, 1000,"%02X ",req[i]);
     strncat(string_expected,expected_req_string,480);
  }
    BufferString[0]=0;
    snprintf(BufferString,1000,"The Request is equal to  :%s",string_expected);
    testStepPass(BufferString);
  
  Variant_Helper_ReportError_Request(req , RequestLength);

  string_expected[0]=0;
  expected_req_string[0]=0;
}

void Variant_Helper_ReportError_Response_Array(byte Expected_Resp[],int ExpectedResponseLength,dword sendTimeout)
{
  int flag;
  byte Actual_Resp_Data[1000];
  char string_actual[1000]="The Actual Response is :";
  char string_expected[1000]="The Expected Response is :";
  char actual_resp_string[1000]="";
  char expected_resp_string[1000]="";
  int value;
  
  
  
  value = sysGetVariableInt(sysvar::Variant);
  
  flag=1;
  
  if(value == variant_FS)
  {
    switch (testWaitForDiagResponse(Request_FS,sendTimeout))
    {
    case 1:
      // check that the expected response is equal to actual response
      Helper_ReportError(diagGetLastResponse(Response_FS));
      Helper_ReportError(diagGetPrimitiveData(Response_FS , Actual_Resp_Data, ExpectedResponseLength));
      if((ExpectedResponseLength)!=diagGetPrimitiveSize(Response_FS))
      {
        //write("response received is %d",diagGetPrimitiveSize(Response_FS));
        testStepFail("Response Recieved not equal in size of Response Expected");
      }
      else
      {
        for ( i = 0 ;i<diagGetPrimitiveSize(Response_FS); i++)
        {
          snprintf(actual_resp_string, 1000," %X",Actual_Resp_Data[i]);
          strncat(string_actual,actual_resp_string,480);
          snprintf(expected_resp_string, 1000," %X",Expected_Resp[i]);
          strncat(string_expected,expected_resp_string,480);
          if(Actual_Resp_Data[i]!=Expected_Resp[i])
          {
            flag = 0;
          }
        }
        if(flag==0)
        {
          BufferString[0]=0;
          strncat(BufferString,string_expected,4000);
          strncat(BufferString," But ",4000);
          strncat(BufferString,string_actual,4000);
          testStepFail(BufferString);
        }
        else
        {
          BufferString[0]=0;
          snprintf(BufferString,1000,"The Expected Response was equal to The Actual Resonse :%s",string_actual);
          testStepPass(BufferString);
        }
        //write(string_actual);
        //write(string_expected);
      break; 
    case 0:
      testStepFail("Response Not Recieved - Timeout");
      flag = 2;
      break;
    default:
      testStepFail("Response Not Recieved - Internal Error");
      flag = 3; 
      break;  
  }

    }
  }
  else if(value == variant_BFS)
  {
    switch (testWaitForDiagResponse(Request_BFS,sendTimeout))
    {
    case 1:
      // check that the expected response is equal to actual response
      Helper_ReportError(diagGetLastResponse(Response_BFS));
      Helper_ReportError(diagGetPrimitiveData(Response_BFS , Actual_Resp_Data, ExpectedResponseLength));
      if((ExpectedResponseLength)!=diagGetPrimitiveSize(Response_BFS))
      {
        //write("response received is %d",diagGetPrimitiveSize(Response_BFS));
        testStepFail("Response Recieved not equal in size of Response Expected");
      }
      else
      {
        for ( i = 0 ;i<diagGetPrimitiveSize(Response_BFS); i++)
        {
          snprintf(actual_resp_string, 1000," %X",Actual_Resp_Data[i]);
          strncat(string_actual,actual_resp_string,480);
          snprintf(expected_resp_string, 1000," %X",Expected_Resp[i]);
          strncat(string_expected,expected_resp_string,480);
          if(Actual_Resp_Data[i]!=Expected_Resp[i])
          {
            flag = 0;
          }
        }
        if(flag==0)
        {
          BufferString[0]=0;
          strncat(BufferString,string_expected,4000);
          strncat(BufferString," But ",4000);
          strncat(BufferString,string_actual,4000);
          testStepFail(BufferString);
        }
        else
        {
          BufferString[0]=0;
          snprintf(BufferString,1000,"The Expected Response was equal to The Actual Resonse :%s",string_actual);
          testStepPass(BufferString);
        }
        //write(string_actual);
        //write(string_expected);
      break; 
    case 0:
      testStepFail("Response Not Recieved - Timeout");
      flag = 2;
      break;
    default:
      testStepFail("Response Not Recieved - Internal Error");
      flag = 3; 
      break;  
    }

    }
  }
  else if(value == variant_HFS)
  {
    
    switch (testWaitForDiagResponse(Request_HFS,sendTimeout))
    {
    case 1:
      // check that the expected response is equal to actual response
      Helper_ReportError(diagGetLastResponse(Response_HFS));
      Helper_ReportError(diagGetPrimitiveData(Response_HFS , Actual_Resp_Data, ExpectedResponseLength));
      if((ExpectedResponseLength)!=diagGetPrimitiveSize(Response_HFS))
      {
        //write("response received is %d",diagGetPrimitiveSize(Response_HFS));
        testStepFail("Response Recieved not equal in size of Response Expected");
      }
      else
      {
        for ( i = 0 ;i<diagGetPrimitiveSize(Response_HFS); i++)
        {
          snprintf(actual_resp_string, 1000," %X",Actual_Resp_Data[i]);
          strncat(string_actual,actual_resp_string,480);
          snprintf(expected_resp_string, 1000," %X",Expected_Resp[i]);
          strncat(string_expected,expected_resp_string,480);
          if(Actual_Resp_Data[i]!=Expected_Resp[i])
          {
            flag = 0;
          }
        }
        if(flag==0)
        {
          BufferString[0]=0;
          strncat(BufferString,string_expected,4000);
          strncat(BufferString," But ",4000);
          strncat(BufferString,string_actual,4000);
          testStepFail(BufferString);
        }
        else
        {
          BufferString[0]=0;
          snprintf(BufferString,1000,"The Expected Response was equal to The Actual Resonse :%s",string_actual);
          testStepPass(BufferString);
        }
        //write(string_actual);
        //write(string_expected);
      break; 
    case 0:
      testStepFail("Response Not Recieved - Timeout");
      flag = 2;
      break;
    default:
      testStepFail("Response Not Recieved - Internal Error");
      flag = 3; 
      break;  
    }

    }
    
  }
  else if(value == variant_HBFS)
  {
    switch (testWaitForDiagResponse(Request_HBFS,sendTimeout))
    {
    case 1:
      // check that the expected response is equal to actual response
      Helper_ReportError(diagGetLastResponse(Response_HBFS));
      Helper_ReportError(diagGetPrimitiveData(Response_HBFS , Actual_Resp_Data, ExpectedResponseLength));
      if((ExpectedResponseLength)!=diagGetPrimitiveSize(Response_HBFS))
      {
        //write("response received is %d",diagGetPrimitiveSize(Response_HBFS));
        testStepFail("Response Recieved not equal in size of Response Expected");
      }
      else
      {
        for ( i = 0 ;i<diagGetPrimitiveSize(Response_HBFS); i++)
        {
          snprintf(actual_resp_string, 1000," %X",Actual_Resp_Data[i]);
          strncat(string_actual,actual_resp_string,480);
          snprintf(expected_resp_string, 1000," %X",Expected_Resp[i]);
          strncat(string_expected,expected_resp_string,480);
          if(Actual_Resp_Data[i]!=Expected_Resp[i])
          {
            flag = 0;
          }
        }
        if(flag==0)
        {
          BufferString[0]=0;
          strncat(BufferString,string_expected,4000);
          strncat(BufferString," But ",4000);
          strncat(BufferString,string_actual,4000);
          testStepFail(BufferString);
        }
        else
        {
          BufferString[0]=0;
          snprintf(BufferString,1000,"The Expected Response was equal to The Actual Resonse :%s",string_actual);
          testStepPass(BufferString);
        }
        //write(string_actual);
        //write(string_expected);
      break; 
    case 0:
      testStepFail("Response Not Recieved - Timeout");
      flag = 2;
      break;
    default:
      testStepFail("Response Not Recieved - Internal Error");
      flag = 3; 
      break;  
    }

    }
    
  }
  
  
  string_actual[0]=0;
  string_expected[0]=0;
  actual_resp_string[0]=0;
  expected_resp_string[0]=0;
  

 
}

void Variant_Helper_ReportError_Response_returnArray(byte Actual_Resp[],int ExpectedResponseLength,dword sendTimeout)
{
  int flag;
  byte Actual_Resp_Data[1000];
  char string_actual[1000]="The Actual Response is :";
  char string_expected[1000]="The Expected Response is :";
  char actual_resp_string[1000]="";
  char expected_resp_string[1000]="";
  int value;
  
  int j;
  
  
  value = sysGetVariableInt(sysvar::Variant);
  
  j = 0;
  
  if(value == variant_FS)
  {
    switch (testWaitForDiagResponse(Request_FS,sendTimeout))
    {
    case 1:
      // check that the expected response is equal to actual response
      Helper_ReportError(diagGetLastResponse(Response_FS));
      Helper_ReportError(diagGetPrimitiveData(Response_FS , Actual_Resp_Data, ExpectedResponseLength));
      if((ExpectedResponseLength)!=diagGetPrimitiveSize(Response_FS))
      {
        //write("response received is %d",diagGetPrimitiveSize(Response_FS));
        testStepFail("Response Recieved not equal in size of Response Expected");
      }
      else
      {
        for ( i = 3 ;i<diagGetPrimitiveSize(Response_FS); i++)
        {
          Actual_Resp[j] = Actual_Resp_Data[i];
          j++;
        }
      
      break; 
    case 0:
      testStepFail("Response Not Recieved - Timeout");
      flag = 2;
      break;
    default:
      testStepFail("Response Not Recieved - Internal Error");
      flag = 3; 
      break;  
      }

    }
  }
  else if(value == variant_BFS)
  {
    switch (testWaitForDiagResponse(Request_BFS,sendTimeout))
    {
    case 1:
      // check that the expected response is equal to actual response
      Helper_ReportError(diagGetLastResponse(Response_BFS));
      Helper_ReportError(diagGetPrimitiveData(Response_BFS , Actual_Resp_Data, ExpectedResponseLength));
      if((ExpectedResponseLength)!=diagGetPrimitiveSize(Response_BFS))
      {
        //write("response received is %d",diagGetPrimitiveSize(Response_BFS));
        testStepFail("Response Recieved not equal in size of Response Expected");
      }
      else
      {
        for ( i = 3 ;i<diagGetPrimitiveSize(Response_BFS); i++)
        {
          Actual_Resp[j] = Actual_Resp_Data[i];
          j++;
        }
      
      break; 
    case 0:
      testStepFail("Response Not Recieved - Timeout");
      flag = 2;
      break;
    default:
      testStepFail("Response Not Recieved - Internal Error");
      flag = 3; 
      break;  
    }

    }
  }
  else if(value == variant_HFS)
  {
    
    switch (testWaitForDiagResponse(Request_HFS,sendTimeout))
    {
    case 1:
      // check that the expected response is equal to actual response
      Helper_ReportError(diagGetLastResponse(Response_HFS));
      Helper_ReportError(diagGetPrimitiveData(Response_HFS , Actual_Resp_Data, ExpectedResponseLength));
      if((ExpectedResponseLength)!=diagGetPrimitiveSize(Response_HFS))
      {
        //write("response received is %d",diagGetPrimitiveSize(Response_HFS));
        testStepFail("Response Recieved not equal in size of Response Expected");
      }
      else
      {
        for ( i = 3 ;i<diagGetPrimitiveSize(Response_HFS); i++)
        {
          Actual_Resp[j] = Actual_Resp_Data[i];
          j++;
        }
      
      break; 
    case 0:
      testStepFail("Response Not Recieved - Timeout");
      flag = 2;
      break;
    default:
      testStepFail("Response Not Recieved - Internal Error");
      flag = 3; 
      break;  
    }

    }
    
  }
  else if(value == variant_HBFS)
  {
    switch (testWaitForDiagResponse(Request_HBFS,sendTimeout))
    {
    case 1:
      // check that the expected response is equal to actual response
      Helper_ReportError(diagGetLastResponse(Response_HBFS));
      Helper_ReportError(diagGetPrimitiveData(Response_HBFS , Actual_Resp_Data, ExpectedResponseLength));
      if((ExpectedResponseLength)!=diagGetPrimitiveSize(Response_HBFS))
      {
        //write("response received is %d",diagGetPrimitiveSize(Response_HBFS));
        testStepFail("Response Recieved not equal in size of Response Expected");
      }
      else
      {
        for ( i = 3 ;i<diagGetPrimitiveSize(Response_HBFS); i++)
        {
          Actual_Resp[j] = Actual_Resp_Data[i];
          j++;
        }
      break; 
    case 0:
      testStepFail("Response Not Recieved - Timeout");
      flag = 2;
      break;
    default:
      testStepFail("Response Not Recieved - Internal Error");
      flag = 3; 
      break;  
    }

    }
    
  }
  
}


void SOK_Variant_Helper_ReportError_Response_returnArray(byte Actual_Resp[],int ExpectedResponseLength,int start_byte,int end_byte,dword sendTimeout)
{
  int flag;
  byte Actual_Resp_Data[1000];
  char string_actual[1000]="The Actual Response is :";
  char string_expected[1000]="The Expected Response is :";
  char actual_resp_string[1000]="";
  char expected_resp_string[1000]="";
  int value;
  
  int j;
  
  
  value = sysGetVariableInt(sysvar::Variant);
  
  j = 0;
  
  if(value == variant_FS)
  {
    switch (testWaitForDiagResponse(Request_FS,sendTimeout))
    {
    case 1:
      // check that the expected response is equal to actual response
      Helper_ReportError(diagGetLastResponse(Response_FS));
      Helper_ReportError(diagGetPrimitiveData(Response_FS , Actual_Resp_Data, ExpectedResponseLength));
      if((ExpectedResponseLength)!=diagGetPrimitiveSize(Response_FS))
      {
        //write("response received is %d",diagGetPrimitiveSize(Response_FS));
        testStepFail("Response Recieved not equal in size of Response Expected");
      }
      else
      {
        for ( i = start_byte ;i<=end_byte; i++)
        {
          Actual_Resp[j] = Actual_Resp_Data[i];
          //write("debug_0: %X" , Actual_Resp_Data[i]);
          j++;
        }
      
      break; 
    case 0:
      testStepFail("Response Not Recieved - Timeout");
      flag = 2;
      break;
    default:
      testStepFail("Response Not Recieved - Internal Error");
      flag = 3; 
      break;  
      }

    }
  }
  else if(value == variant_BFS)
  {
    switch (testWaitForDiagResponse(Request_BFS,sendTimeout))
    {
    case 1:
      // check that the expected response is equal to actual response
      Helper_ReportError(diagGetLastResponse(Response_BFS));
      Helper_ReportError(diagGetPrimitiveData(Response_BFS , Actual_Resp_Data, ExpectedResponseLength));
      if((ExpectedResponseLength)!=diagGetPrimitiveSize(Response_BFS))
      {
        //write("response received is %d",diagGetPrimitiveSize(Response_BFS));
        testStepFail("Response Recieved not equal in size of Response Expected");
      }
      else
      {
        for ( i = start_byte ;i<=end_byte; i++)
        {
          Actual_Resp[j] = Actual_Resp_Data[i];
          j++;
        }
      
      break; 
    case 0:
      testStepFail("Response Not Recieved - Timeout");
      flag = 2;
      break;
    default:
      testStepFail("Response Not Recieved - Internal Error");
      flag = 3; 
      break;  
    }

    }
  }
  else if(value == variant_HFS)
  {
    
    switch (testWaitForDiagResponse(Request_HFS,sendTimeout))
    {
    case 1:
      // check that the expected response is equal to actual response
      Helper_ReportError(diagGetLastResponse(Response_HFS));
      Helper_ReportError(diagGetPrimitiveData(Response_HFS , Actual_Resp_Data, ExpectedResponseLength));
      if((ExpectedResponseLength)!=diagGetPrimitiveSize(Response_HFS))
      {
        //write("response received is %d",diagGetPrimitiveSize(Response_HFS));
        testStepFail("Response Recieved not equal in size of Response Expected");
      }
      else
      {
        for ( i = start_byte ;i<=end_byte; i++)
        {
          Actual_Resp[j] = Actual_Resp_Data[i];
          j++;
        }
      
      break; 
    case 0:
      testStepFail("Response Not Recieved - Timeout");
      flag = 2;
      break;
    default:
      testStepFail("Response Not Recieved - Internal Error");
      flag = 3; 
      break;  
    }

    }
    
  }
  else if(value == variant_HBFS)
  {
    switch (testWaitForDiagResponse(Request_HBFS,sendTimeout))
    {
    case 1:
      // check that the expected response is equal to actual response
      Helper_ReportError(diagGetLastResponse(Response_HBFS));
      Helper_ReportError(diagGetPrimitiveData(Response_HBFS , Actual_Resp_Data, ExpectedResponseLength));
      if((ExpectedResponseLength)!=diagGetPrimitiveSize(Response_HBFS))
      {
        //write("response received is %d",diagGetPrimitiveSize(Response_HBFS));
        testStepFail("Response Recieved not equal in size of Response Expected");
      }
      else
      {
        for ( i = start_byte ;i<=end_byte; i++)
        {
          Actual_Resp[j] = Actual_Resp_Data[i];
          j++;
        }
      break; 
    case 0:
      testStepFail("Response Not Recieved - Timeout");
      flag = 2;
      break;
    default:
      testStepFail("Response Not Recieved - Internal Error");
      flag = 3; 
      break;  
    }

    }
    
  }
  
}

int Variant_Helper_ReportError_Response_Array_ReturnError(byte Expected_Resp[],int ExpectedResponseLength,dword sendTimeout)
{
  int flag;
  byte Actual_Resp_Data[1000];
  char string_actual[1000]="The Actual Response is :";
  char string_expected[1000]="The Expected Response is :";
  char actual_resp_string[1000]="";
  char expected_resp_string[1000]="";
  int value;
  int error_val;
  
  
  value = sysGetVariableInt(sysvar::Variant);
  error_val=0;
  flag=1;
  
  if(value == variant_FS)
  {
    switch (testWaitForDiagResponse(Request_FS,sendTimeout))
    {
    case 1:
      // check that the expected response is equal to actual response
      Helper_ReportError(diagGetLastResponse(Response_FS));
      Helper_ReportError(diagGetPrimitiveData(Response_FS , Actual_Resp_Data, ExpectedResponseLength));
      if((ExpectedResponseLength)!=diagGetPrimitiveSize(Response_FS))
      {
        //write("response received is %d",diagGetPrimitiveSize(Response_FS));
        testStepFail("Response Recieved not equal in size of Response Expected");
      }
      else
      {
        for ( i = 0 ;i<diagGetPrimitiveSize(Response_FS); i++)
        {
          snprintf(actual_resp_string, 1000," %X",Actual_Resp_Data[i]);
          strncat(string_actual,actual_resp_string,480);
          snprintf(expected_resp_string, 1000," %X",Expected_Resp[i]);
          strncat(string_expected,expected_resp_string,480);
          if(Actual_Resp_Data[i]!=Expected_Resp[i])
          {
            flag = 0;
          }
        }
        if(flag==0)
        {
          BufferString[0]=0;
          strncat(BufferString,string_expected,4000);
          strncat(BufferString," But ",4000);
          strncat(BufferString,string_actual,4000);
          //testStepFail(BufferString);
        }
        else
        {
          BufferString[0]=0;
          snprintf(BufferString,1000,"The Expected Response was equal to The Actual Resonse :%s",string_actual);
          testStepPass(BufferString);
        }
        //write(string_actual);
        //write(string_expected);
      break; 
    case 0:
      testStepFail("Response Not Recieved - Timeout");
      flag = 2;
      break;
    default:
      testStepFail("Response Not Recieved - Internal Error");
      flag = 3; 
      break;  
  }

    }
  }
  else if(value == variant_BFS)
  {
    switch (testWaitForDiagResponse(Request_BFS,sendTimeout))
    {
    case 1:
      // check that the expected response is equal to actual response
      Helper_ReportError(diagGetLastResponse(Response_BFS));
      Helper_ReportError(diagGetPrimitiveData(Response_BFS , Actual_Resp_Data, ExpectedResponseLength));
      if((ExpectedResponseLength)!=diagGetPrimitiveSize(Response_BFS))
      {
        //write("response received is %d",diagGetPrimitiveSize(Response_BFS));
        testStepFail("Response Recieved not equal in size of Response Expected");
      }
      else
      {
        for ( i = 0 ;i<diagGetPrimitiveSize(Response_BFS); i++)
        {
          snprintf(actual_resp_string, 1000," %X",Actual_Resp_Data[i]);
          strncat(string_actual,actual_resp_string,480);
          snprintf(expected_resp_string, 1000," %X",Expected_Resp[i]);
          strncat(string_expected,expected_resp_string,480);
          if(Actual_Resp_Data[i]!=Expected_Resp[i])
          {
            flag = 0;
          }
        }
        if(flag==0)
        {
          BufferString[0]=0;
          strncat(BufferString,string_expected,4000);
          strncat(BufferString," But ",4000);
          strncat(BufferString,string_actual,4000);
          //testStepFail(BufferString);
        }
        else
        {
          BufferString[0]=0;
          snprintf(BufferString,1000,"The Expected Response was equal to The Actual Resonse :%s",string_actual);
          testStepPass(BufferString);
        }
        //write(string_actual);
        //write(string_expected);
      break; 
    case 0:
      testStepFail("Response Not Recieved - Timeout");
      flag = 2;
      break;
    default:
      testStepFail("Response Not Recieved - Internal Error");
      flag = 3; 
      break;  
    }

    }
  }
  else if(value == variant_HFS)
  {
    
    switch (testWaitForDiagResponse(Request_HFS,sendTimeout))
    {
    case 1:
      // check that the expected response is equal to actual response
      Helper_ReportError(diagGetLastResponse(Response_HFS));
      Helper_ReportError(diagGetPrimitiveData(Response_HFS , Actual_Resp_Data, ExpectedResponseLength));
      if((ExpectedResponseLength)!=diagGetPrimitiveSize(Response_HFS))
      {
        //write("response received is %d",diagGetPrimitiveSize(Response_HFS));
        testStepFail("Response Recieved not equal in size of Response Expected");
      }
      else
      {
        for ( i = 0 ;i<diagGetPrimitiveSize(Response_HFS); i++)
        {
          snprintf(actual_resp_string, 1000," %X",Actual_Resp_Data[i]);
          strncat(string_actual,actual_resp_string,480);
          snprintf(expected_resp_string, 1000," %X",Expected_Resp[i]);
          strncat(string_expected,expected_resp_string,480);
          if(Actual_Resp_Data[i]!=Expected_Resp[i])
          {
            flag = 0;
          }
        }
        if(flag==0)
        {
          BufferString[0]=0;
          strncat(BufferString,string_expected,4000);
          strncat(BufferString," But ",4000);
          strncat(BufferString,string_actual,4000);
          //testStepFail(BufferString);
        }
        else
        {
          BufferString[0]=0;
          snprintf(BufferString,1000,"The Expected Response was equal to The Actual Resonse :%s",string_actual);
          testStepPass(BufferString);
        }
        //write(string_actual);
        //write(string_expected);
      break; 
    case 0:
      testStepFail("Response Not Recieved - Timeout");
      flag = 2;
      break;
    default:
      testStepFail("Response Not Recieved - Internal Error");
      flag = 3; 
      break;  
    }

    }
    
  }
  else if(value == variant_HBFS)
  {
    switch (testWaitForDiagResponse(Request_HBFS,sendTimeout))
    {
    case 1:
      // check that the expected response is equal to actual response
      Helper_ReportError(diagGetLastResponse(Response_HBFS));
      Helper_ReportError(diagGetPrimitiveData(Response_HBFS , Actual_Resp_Data, ExpectedResponseLength));
      if((ExpectedResponseLength)!=diagGetPrimitiveSize(Response_HBFS))
      {
        //write("response received is %d",diagGetPrimitiveSize(Response_HBFS));
        testStepFail("Response Recieved not equal in size of Response Expected");
      }
      else
      {
        for ( i = 0 ;i<diagGetPrimitiveSize(Response_HBFS); i++)
        {
          snprintf(actual_resp_string, 1000," %X",Actual_Resp_Data[i]);
          strncat(string_actual,actual_resp_string,480);
          snprintf(expected_resp_string, 1000," %X",Expected_Resp[i]);
          strncat(string_expected,expected_resp_string,480);
          if(Actual_Resp_Data[i]!=Expected_Resp[i])
          {
            flag = 0;
          }
        }
        if(flag==0)
        {
          BufferString[0]=0;
          strncat(BufferString,string_expected,4000);
          strncat(BufferString," But ",4000);
          strncat(BufferString,string_actual,4000);
          //testStepFail(BufferString);
        }
        else
        {
          BufferString[0]=0;
          snprintf(BufferString,1000,"The Expected Response was equal to The Actual Resonse :%s",string_actual);
          testStepPass(BufferString);
        }
        //write(string_actual);
        //write(string_expected);
      break; 
    case 0:
      testStepFail("Response Not Recieved - Timeout");
      flag = 2;
      break;
    default:
      testStepFail("Response Not Recieved - Internal Error");
      flag = 3; 
      break;  
    }

    }
    
  }
  
  
  string_actual[0]=0;
  string_expected[0]=0;
  actual_resp_string[0]=0;
  expected_resp_string[0]=0;
  
  if(flag == 1)
  {
    error_val = 1;
  }
  
  return error_val;
}

int Variant_Helper_ReportError_Response_ReturnValue(char ResponseString[],dword sendTimeout,char meaning[])
{
  int value;
  byte Actual_Resp_Data[1000];
  char string_actual[1000]="The Actual Response is :";
  char string_expected[1000]="The Expected Response is :";
  char actual_resp_string[1000]="";
  char expected_resp_string[1000]="";
  byte Expected_Resp[1000];
  int ExpectedResponseLength;
  
  value = sysGetVariableInt(sysvar::Variant);
  

  
  snprintf(BufferString,1000,"check Response Recieved is equal to: %s  ,Which means [%s]",ResponseString,meaning);
  TestExpectation(BufferString);
  
  ExpectedResponseLength = Convert_String_To_Hex(ResponseString,Expected_Resp);
  
  if(value == variant_FS)
  {
      switch (testWaitForDiagResponse(Request_FS,sendTimeout))
      {
        case 1:
          // check that the expected response is equal to actual response
          Helper_ReportError(diagGetLastResponse(Response_FS));
          Helper_ReportError(diagGetPrimitiveData(Response_FS , Actual_Resp_Data, ExpectedResponseLength));
          if((ExpectedResponseLength)!=diagGetPrimitiveSize(Response_FS))
          {
           // write("ExpectedResponseLength = %d",ExpectedResponseLength);
            //write("ActualResponseLength = %d",diagGetPrimitiveSize(Response_FS));
            //testStepFail("Response Recieved not equal in size of Response Expected");
          }
          else
          {
            //write("acual resp data is %d",Actual_Resp_Data[5]);
          }
          break; 
        case 0:
           //testStepFail("Response Not Recieved - Timeout");
          break;
        default:
          break;  
      }
  }
  else if(value == variant_BFS)
  {
      switch (testWaitForDiagResponse(Request_BFS,sendTimeout))
      {
        case 1:
          // check that the expected response is equal to actual response
          Helper_ReportError(diagGetLastResponse(Response_BFS));
          Helper_ReportError(diagGetPrimitiveData(Response_BFS , Actual_Resp_Data, ExpectedResponseLength));
          if((ExpectedResponseLength)!=diagGetPrimitiveSize(Response_BFS))
          {
            //testStepFail("Response Recieved not equal in size of Response Expected");
          }
          else
          {
            //write("acual resp data is %d",Actual_Resp_Data[5]);
          }
          break; 
        case 0:
           //testStepFail("Response Not Recieved - Timeout");
          break;
        default:
          break;  
      }
    
  }
  else if(value == variant_HFS)
  {
      switch (testWaitForDiagResponse(Request_HFS,sendTimeout))
      {
        case 1:
          // check that the expected response is equal to actual response
          Helper_ReportError(diagGetLastResponse(Response_HFS));
          Helper_ReportError(diagGetPrimitiveData(Response_HFS , Actual_Resp_Data, ExpectedResponseLength));
          if((ExpectedResponseLength)!=diagGetPrimitiveSize(Response_HFS))
          {
            //testStepFail("Response Recieved not equal in size of Response Expected");
          }
          else
          {
            //write("acual resp data is %d",Actual_Resp_Data[5]);
          }
          break; 
        case 0:
           //testStepFail("Response Not Recieved - Timeout");
          break;
        default:
          break;  
      }
    
  }
  else if(value == variant_HBFS)
  {
      switch (testWaitForDiagResponse(Request_HBFS,sendTimeout))
      {
        case 1:
          // check that the expected response is equal to actual response
          Helper_ReportError(diagGetLastResponse(Response_HBFS));
          Helper_ReportError(diagGetPrimitiveData(Response_HBFS , Actual_Resp_Data, ExpectedResponseLength));
          if((ExpectedResponseLength)!=diagGetPrimitiveSize(Response_HBFS))
          {
            //testStepFail("Response Recieved not equal in size of Response Expected");
          }
          else
          {
            //write("acual resp data is %d",Actual_Resp_Data[5]);
          }
          break; 
        case 0:
           //testStepFail("Response Not Recieved - Timeout");
          break;
        default:
          break;  
      }
    
  }
  actual_resp_string[0] = 0;
  return Actual_Resp_Data[5];
}

int SOK_Variant_Helper_ReportError_Response_ReturnValue(byte status_byte,int ExpectedResponseLength,dword sendTimeout)
{
  int value;
  byte Actual_Resp_Data[1000];
  char string_actual[1000]="The Actual Response is :";
  char string_expected[1000]="The Expected Response is :";
  char actual_resp_string[1000]="";
  char expected_resp_string[1000]="";
  byte Expected_Resp[1000];

  
  value = sysGetVariableInt(sysvar::Variant);
  
  
  if(value == variant_FS)
  {
      switch (testWaitForDiagResponse(Request_FS,sendTimeout))
      {
        case 1:
          // check that the expected response is equal to actual response
          Helper_ReportError(diagGetLastResponse(Response_FS));
          Helper_ReportError(diagGetPrimitiveData(Response_FS , Actual_Resp_Data, ExpectedResponseLength));
       
          //write("acual resp data is %d",Actual_Resp_Data[status_byte]);
          
          break; 
        case 0:
           //testStepFail("Response Not Recieved - Timeout");
          break;
        default:
          break;  
      }
  }
  else if(value == variant_BFS)
  {
      switch (testWaitForDiagResponse(Request_BFS,sendTimeout))
      {
        case 1:
          // check that the expected response is equal to actual response
          Helper_ReportError(diagGetLastResponse(Response_BFS));
          Helper_ReportError(diagGetPrimitiveData(Response_BFS , Actual_Resp_Data, ExpectedResponseLength));
        
          
          //write("acual resp data is %d",Actual_Resp_Data[status_byte]);
          
          break; 
        case 0:
           //testStepFail("Response Not Recieved - Timeout");
          break;
        default:
          break;  
      }
    
  }
  else if(value == variant_HFS)
  {
      switch (testWaitForDiagResponse(Request_HFS,sendTimeout))
      {
        case 1:
          // check that the expected response is equal to actual response
          Helper_ReportError(diagGetLastResponse(Response_HFS));
          Helper_ReportError(diagGetPrimitiveData(Response_HFS , Actual_Resp_Data, ExpectedResponseLength));
          if((ExpectedResponseLength)!=diagGetPrimitiveSize(Response_HFS))
          {
            //testStepFail("Response Recieved not equal in size of Response Expected");
          }
          else
          {
            //write("acual resp data is %d",Actual_Resp_Data[status_byte]);
          }
          break; 
        case 0:
           //testStepFail("Response Not Recieved - Timeout");
          break;
        default:
          break;  
      }
    
  }
  else if(value == variant_HBFS)
  {
      switch (testWaitForDiagResponse(Request_HBFS,sendTimeout))
      {
        case 1:
          // check that the expected response is equal to actual response
          Helper_ReportError(diagGetLastResponse(Response_HBFS));
          Helper_ReportError(diagGetPrimitiveData(Response_HBFS , Actual_Resp_Data, ExpectedResponseLength));
     
          
          //write("acual resp data is %d",Actual_Resp_Data[status_byte]);
          
          break; 
        case 0:
           //testStepFail("Response Not Recieved - Timeout");
          break;
        default:
          break;  
      }
    
  }
  actual_resp_string[0] = 0;
   //write("acual resp data is %d",Actual_Resp_Data[status_byte]);
  return Actual_Resp_Data[status_byte];
}

void Variant_Helper_ReportError_Response(char ResponseString[],dword sendTimeout,char meaning[])
{
  int value;
  int flag;
  byte Actual_Resp_Data[1000];
  char string_actual[1000]="The Actual Response is :";
  char string_expected[1000]="The Expected Response is :";
  char actual_resp_string[1000]="";
  char expected_resp_string[1000]="";
  int ResponseCode = 0;
  
  byte Expected_Resp[1000];
  int ExpectedResponseLength;
  flag=1;
  ExpectedResponseLength = Convert_String_To_Hex(ResponseString,Expected_Resp);
  
  snprintf(BufferString,1000,"check Response Recieved is equal to: %s  ,Which means [%s]",ResponseString,meaning);
  TestExpectation(BufferString);
  
  value = sysGetVariableInt(sysvar::Variant);
  
  if(value == variant_FS)
  {
      switch (testWaitForDiagResponse(Request_FS))
      {
        case 1:
          // check that the expected response is equal to actual response
          Helper_ReportError(diagGetLastResponse(Response_FS));
          Helper_ReportError(diagGetPrimitiveData(Response_FS , Actual_Resp_Data, ExpectedResponseLength));
          if((ExpectedResponseLength)!=diagGetPrimitiveSize(Response_FS))
          {
            //write("ExpectedResponseLength is %d",ExpectedResponseLength);
            //write("ActualResponseLength is %d",diagGetPrimitiveSize(Response_FS));
            for ( i = 0 ;i<diagGetPrimitiveSize(Response_FS); i++)
            {
              snprintf(actual_resp_string, 1000," %X",Actual_Resp_Data[i]);
              strncat(string_actual,actual_resp_string,480);
            }
            BufferString[0]=0;
            snprintf(BufferString,1000,"Response Recieved not equal in size of Response Expected. Actual response is:%s",string_actual);
            testStepFail(BufferString);
            //write(string_actual);
          }
          else
          {
            for ( i = 0 ;i<diagGetPrimitiveSize(Response_FS); i++)
            {
              snprintf(actual_resp_string, 1000," %X",Actual_Resp_Data[i]);
              strncat(string_actual,actual_resp_string,480);
              snprintf(expected_resp_string, 1000," %X",Expected_Resp[i]);
              strncat(string_expected,expected_resp_string,480);
              if(Actual_Resp_Data[i]!=Expected_Resp[i])
              {
                flag = 0;
              }
            }
            if(flag==0)
            {
              BufferString[0]=0;
              strncat(BufferString,string_expected,4000);
              strncat(BufferString," But ",4000);
              strncat(BufferString,string_actual,4000);
              testStepFail(BufferString);
            }
            else
            {
              BufferString[0]=0;
              snprintf(BufferString,1000,"The Expected Response was equal to The Actual Resonse :%s",string_actual);
              testStepPass(BufferString);
            }
            //write(string_actual);
            //write(string_expected);
          break; 
        case 0:
          testStepFail("Response Not Recieved - Timeout");
          break;
        default:
          testStepFail("Response Not Recieved - Internal Error");
          break;  
      }
    
      }
    
  }
  else if(value == variant_BFS)
  {
      //write("BFSBFSBFSsssssssssssssssss");
      switch (testWaitForDiagResponse(Request_BFS,sendTimeout))
      {
        case 1:
          // check that the expected response is equal to actual response
          Helper_ReportError(diagGetLastResponse(Response_BFS));
          Helper_ReportError(diagGetPrimitiveData(Response_BFS , Actual_Resp_Data, ExpectedResponseLength));
          if((ExpectedResponseLength)!=diagGetPrimitiveSize(Response_BFS))
          {
            //write("ExpectedResponseLength is %d",ExpectedResponseLength);
            //write("ActualResponseLength is %d",diagGetPrimitiveSize(Response_BFS));
            for ( i = 0 ;i<diagGetPrimitiveSize(Response_BFS); i++)
            {
              snprintf(actual_resp_string, 1000," %X",Actual_Resp_Data[i]);
              strncat(string_actual,actual_resp_string,480);
            }
            BufferString[0]=0;
            snprintf(BufferString,1000,"Response Recieved not equal in size of Response Expected. Actual response is:%s",string_actual);
            testStepFail(BufferString);
            //write(string_actual);
          }
          else
          {
            for ( i = 0 ;i<diagGetPrimitiveSize(Response_BFS); i++)
            {
              snprintf(actual_resp_string, 1000," %X",Actual_Resp_Data[i]);
              strncat(string_actual,actual_resp_string,480);
              snprintf(expected_resp_string, 1000," %X",Expected_Resp[i]);
              strncat(string_expected,expected_resp_string,480);
              if(Actual_Resp_Data[i]!=Expected_Resp[i])
              {
                flag = 0;
              }
            }
            if(flag==0)
            {
              BufferString[0]=0;
              strncat(BufferString,string_expected,4000);
              strncat(BufferString," But ",4000);
              strncat(BufferString,string_actual,4000);
              testStepFail(BufferString);
            }
            else
            {
              BufferString[0]=0;
              snprintf(BufferString,1000,"The Expected Response was equal to The Actual Resonse :%s",string_actual);
              testStepPass(BufferString);
            }
            //write(string_actual);
            //write(string_expected);
          break; 
        case 0:
          testStepFail("Response Not Recieved - Timeout");
          break;
        default:
          testStepFail("Response Not Recieved - Internal Error");
          break;  
      }
    
      }
    
  }
  else if(value == variant_HFS)
  {
      switch (testWaitForDiagResponse(Request_HFS,sendTimeout))
      {
        case 1:
          // check that the expected response is equal to actual response
          Helper_ReportError(diagGetLastResponse(Response_HFS));
          Helper_ReportError(diagGetPrimitiveData(Response_HFS , Actual_Resp_Data, ExpectedResponseLength));
          if((ExpectedResponseLength)!=diagGetPrimitiveSize(Response_HFS))
          {
            //write("ExpectedResponseLength is %d",ExpectedResponseLength);
            //write("ActualResponseLength is %d",diagGetPrimitiveSize(Response_HFS));
            for ( i = 0 ;i<diagGetPrimitiveSize(Response_HFS); i++)
            {
              snprintf(actual_resp_string, 1000," %X",Actual_Resp_Data[i]);
              strncat(string_actual,actual_resp_string,480);
            }
            BufferString[0]=0;
            snprintf(BufferString,1000,"Response Recieved not equal in size of Response Expected. Actual response is:%s",string_actual);
            testStepFail(BufferString);
            //write(string_actual);
          }
          else
          {
            for ( i = 0 ;i<diagGetPrimitiveSize(Response_HFS); i++)
            {
              snprintf(actual_resp_string, 1000," %X",Actual_Resp_Data[i]);
              strncat(string_actual,actual_resp_string,480);
              snprintf(expected_resp_string, 1000," %X",Expected_Resp[i]);
              strncat(string_expected,expected_resp_string,480);
              if(Actual_Resp_Data[i]!=Expected_Resp[i])
              {
                flag = 0;
              }
            }
            if(flag==0)
            {
              BufferString[0]=0;
              strncat(BufferString,string_expected,4000);
              strncat(BufferString," But ",4000);
              strncat(BufferString,string_actual,4000);
              testStepFail(BufferString);
            }
            else
            {
              BufferString[0]=0;
              snprintf(BufferString,1000,"The Expected Response was equal to The Actual Resonse :%s",string_actual);
              testStepPass(BufferString);
            }
            //write(string_actual);
            //write(string_expected);
          break; 
        case 0:
          testStepFail("Response Not Recieved - Timeout");
          break;
        default:
          testStepFail("Response Not Recieved - Internal Error");
          break;  
      }
    
      }
    
  }
  else if(value == variant_HBFS)
  {
      switch (testWaitForDiagResponse(Request_HBFS,sendTimeout))
      {
        case 1:
          // check that the expected response is equal to actual response
          Helper_ReportError(diagGetLastResponse(Response_HBFS));
          Helper_ReportError(diagGetPrimitiveData(Response_HBFS , Actual_Resp_Data, ExpectedResponseLength));
          if((ExpectedResponseLength)!=diagGetPrimitiveSize(Response_HBFS))
          {
            //write("ExpectedResponseLength is %d",ExpectedResponseLength);
            //write("ActualResponseLength is %d",diagGetPrimitiveSize(Response_HBFS));
            for ( i = 0 ;i<diagGetPrimitiveSize(Response_HFS); i++)
            {
              snprintf(actual_resp_string, 1000," %X",Actual_Resp_Data[i]);
              strncat(string_actual,actual_resp_string,480);
            }
            BufferString[0]=0;
            snprintf(BufferString,1000,"Response Recieved not equal in size of Response Expected. Actual response is:%s",string_actual);
            testStepFail(BufferString);
            //write(string_actual);
          }
          else
          {
            for ( i = 0 ;i<diagGetPrimitiveSize(Response_HBFS); i++)
            {
              snprintf(actual_resp_string, 1000," %X",Actual_Resp_Data[i]);
              strncat(string_actual,actual_resp_string,480);
              snprintf(expected_resp_string, 1000," %X",Expected_Resp[i]);
              strncat(string_expected,expected_resp_string,480);
              if(Actual_Resp_Data[i]!=Expected_Resp[i])
              {
                flag = 0;
              }
            }
            if(flag==0)
            {
              BufferString[0]=0;
              strncat(BufferString,string_expected,4000);
              strncat(BufferString," But ",4000);
              strncat(BufferString,string_actual,4000);
              testStepFail(BufferString);
            }
            else
            {
              BufferString[0]=0;
              snprintf(BufferString,1000,"The Expected Response was equal to The Actual Resonse :%s",string_actual);
              testStepPass(BufferString);
            }
            //write(string_actual);
            //write(string_expected);
          break; 
        case 0:
          testStepFail("Response Not Recieved - Timeout");
          break;
        default:
          testStepFail("Response Not Recieved - Internal Error");
          break;  
      }
    
      }
    
  }
  
  string_actual[0]=0;
  string_expected[0]=0;
  actual_resp_string[0]=0;
  expected_resp_string[0]=0;
  
  
}
void checkDiagnosticsResponse_array(byte Expected_Resp[] , int ExpectedResponseLength,dword sendTimeout,char meaning[])
{
  DiagInit();
   Variant_Helper_ReportError_Response_Array(Expected_Resp,ExpectedResponseLength,sendTimeout); 
}

void checkDiagnosticsResponse_returnArray(byte Actual_Resp[] , int ExpectedResponseLength,dword sendTimeout)
{
  DiagInit();
   Variant_Helper_ReportError_Response_returnArray(Actual_Resp,ExpectedResponseLength,sendTimeout); 
}

void SOK_checkDiagnosticsResponse_returnArray(byte Actual_Resp[] , int ExpectedResponseLength,int start_byte,int end_byte,dword sendTimeout)
{
   DiagInit();
   SOK_Variant_Helper_ReportError_Response_returnArray(Actual_Resp,ExpectedResponseLength,start_byte,end_byte,sendTimeout); 
}

int checkDiagnosticsResponse_array_returnError(byte Expected_Resp[] , int ExpectedResponseLength,dword sendTimeout,char meaning[])
{
  int val;
  DiagInit();
   val = Variant_Helper_ReportError_Response_Array_ReturnError(Expected_Resp,ExpectedResponseLength,sendTimeout); 
  return val;
}

int checkDiagnosticsResponse_returnValue(char ResponseString[],dword sendTimeout,char meaning[])
{
  int val;
  DiagInit();
  val = Variant_Helper_ReportError_Response_ReturnValue(ResponseString,sendTimeout,meaning);
  
  return val;
}

int SOK_checkDiagnosticsResponse_returnValue(byte status_byte,int ExpectedResponseLength,dword sendTimeout)
{
  int val;
  DiagInit();
  val = SOK_Variant_Helper_ReportError_Response_ReturnValue(status_byte,ExpectedResponseLength,sendTimeout);
  
  return val;
}

void checkDiagnosticsResponse(char ResponseString[],dword sendTimeout,char meaning[])
{
  DiagInit();
  Variant_Helper_ReportError_Response(ResponseString,sendTimeout,meaning);
}

void Helper_ReportError_checkDTCObtained_withMask(byte DTC3Bytes[], byte DTCMask,dword sendTimeout,char meaning[])
{
  int value;
  int flag;
  byte Actual_Resp_Data[1000];
  char string_actual[1000]="The Actual Response is :";
  char string_expected[1000]="The Expected Response is :";
  char actual_resp_string[1000]="";
  char expected_resp_string[1000]="";
  byte obtainedMask;
  int ResponseCode = 0;
  
  byte Expected_Resp[1000];
  flag=0;

  snprintf(BufferString,1000,"check DTC %d%d%d is received within current diag response ,Which means [%s]",DTC3Bytes[0],DTC3Bytes[1],DTC3Bytes[2],meaning);
  TestExpectation(BufferString);
  
  value = sysGetVariableInt(sysvar::Variant);
  
  
  if(value == variant_FS)
  {
      switch (testWaitForDiagResponse(Request_FS,sendTimeout))
      {
        case 1:
          // check that the expected response is equal to actual response
          Helper_ReportError(diagGetLastResponse(Response_FS));
          Helper_ReportError(diagGetPrimitiveData(Response_FS , Actual_Resp_Data, 75));
          if(diagGetPrimitiveSize(Response_FS)<=3)
          {
            testStepFail("Response Recieved not equal in size of Expected Response");
            //write("test string is %X",Actual_Resp_Data[0]);
          }
          else 
          {
            //write("test string is %X",Actual_Resp_Data[0]);
            for ( i = 3 ;i<diagGetPrimitiveSize(Response_FS); i=i+4)
            {
              if(Actual_Resp_Data[i]==DTC3Bytes[0]&&
              Actual_Resp_Data[i+1]==DTC3Bytes[1]&&
              Actual_Resp_Data[i+2]==DTC3Bytes[2])
              {
                flag = 1;
                obtainedMask = Actual_Resp_Data[i+3];
                if(obtainedMask==DTCMask){
                  flag=2;
                  //write("test string is %X",Actual_Resp_Data[0]);
                  //break;
                }
                  
               
              }
              snprintf(BufferString,1000,"check DTC %d%d%d is received within current diag response ,Which means [%s]",Actual_Resp_Data[i],Actual_Resp_Data[i+1],Actual_Resp_Data[i+2],meaning);
              //write(BufferString);
            }
          
            if(flag==0)
            {
              BufferString[0]=0;
              snprintf(BufferString,4000,"DTC 0x%02x%02x%02x not Found in last Diag response",DTC3Bytes[0],DTC3Bytes[1],DTC3Bytes[2]);
              testStepFail(BufferString);
            }
            else if (flag == 1)
            {
              BufferString[0]=0;
              snprintf(BufferString,1000,"DTC found but with different mask, expected mask: 0x%02x, Obtained mask: 0x%02x",DTCMask, obtainedMask);
              testStepFail(BufferString);
            }
            else 
            {
              BufferString[0]=0;
              snprintf(BufferString,1000,"DTC 0x%02x%02x%02x found with expected mask: 0x%02x",DTC3Bytes[0],DTC3Bytes[1],DTC3Bytes[2],DTCMask);
              testStepPass(BufferString);
            }
            
          }
    
          break; 
        case 0:
          testStepFail("Response Not Recieved - Timeout");
          break;
        default:
          testStepFail("Response Not Recieved - Internal Error");
          break;  
      }
    
  }
  else if(value == variant_BFS)
  {
        switch (testWaitForDiagResponse(Request_BFS,sendTimeout))
      {
        case 1:
          // check that the expected response is equal to actual response
          Helper_ReportError(diagGetLastResponse(Response_BFS));
          Helper_ReportError(diagGetPrimitiveData(Response_BFS , Actual_Resp_Data, 75));
          if(diagGetPrimitiveSize(Response_BFS)<=3)
          {
            testStepFail("Response Recieved not equal in size of Expected Response");
            //write("test string is %X",Actual_Resp_Data[0]);
          }
          else 
          {
            //write("test string is %X",Actual_Resp_Data[0]);
            for ( i = 3 ;i<diagGetPrimitiveSize(Response_BFS); i=i+4)
            {
              if(Actual_Resp_Data[i]==DTC3Bytes[0]&&
              Actual_Resp_Data[i+1]==DTC3Bytes[1]&&
              Actual_Resp_Data[i+2]==DTC3Bytes[2])
              {
                flag = 1;
                obtainedMask = Actual_Resp_Data[i+3];
                if(obtainedMask==DTCMask){
                  flag=2;
                  //write("test string is %X",Actual_Resp_Data[0]);
                 // break;
                }
                  
               
              }
              snprintf(BufferString,1000,"check DTC %d%d%d is received within current diag response ,Which means [%s]",Actual_Resp_Data[i],Actual_Resp_Data[i+1],Actual_Resp_Data[i+2],meaning);
              //write(BufferString);
            }
          
            if(flag==0)
            {
              BufferString[0]=0;
              snprintf(BufferString,4000,"DTC 0x%02x%02x%02x not Found in last Diag response",DTC3Bytes[0],DTC3Bytes[1],DTC3Bytes[2]);
              testStepFail(BufferString);
            }
            else if (flag == 1)
            {
              BufferString[0]=0;
              snprintf(BufferString,1000,"DTC found but with different mask, expected mask: 0x%02x, Obtained mask: 0x%02x",DTCMask, obtainedMask);
              testStepFail(BufferString);
            }
            else 
            {
              BufferString[0]=0;
              snprintf(BufferString,1000,"DTC 0x%02x%02x%02x found with expected mask: 0x%02x",DTC3Bytes[0],DTC3Bytes[1],DTC3Bytes[2],DTCMask);
              testStepPass(BufferString);
            }
            
          }
    
          break; 
        case 0:
          testStepFail("Response Not Recieved - Timeout");
          break;
        default:
          testStepFail("Response Not Recieved - Internal Error");
          break;  
      }
  }
  else if(value == variant_HFS)
  {
    
      switch (testWaitForDiagResponse(Request_HFS,sendTimeout))
      {
        case 1:
          // check that the expected response is equal to actual response
          Helper_ReportError(diagGetLastResponse(Response_HFS));
          Helper_ReportError(diagGetPrimitiveData(Response_HFS , Actual_Resp_Data, 75));
          if(diagGetPrimitiveSize(Response_HFS)<=3)
          {
            testStepFail("Response Recieved not equal in size of Expected Response");
            //write("test string is %X",Actual_Resp_Data[0]);
          }
          else 
          {
            //write("test string is %X",Actual_Resp_Data[0]);
            for ( i = 3 ;i<diagGetPrimitiveSize(Response_HFS); i=i+4)
            {
              if(Actual_Resp_Data[i]==DTC3Bytes[0]&&
              Actual_Resp_Data[i+1]==DTC3Bytes[1]&&
              Actual_Resp_Data[i+2]==DTC3Bytes[2])
              {
                flag = 1;
                obtainedMask = Actual_Resp_Data[i+3];
                if(obtainedMask==DTCMask){
                  flag=2;
                  //write("test string is %X",Actual_Resp_Data[0]);
                  //break;
                }
                  
               
              }
              snprintf(BufferString,1000,"check DTC %d%d%d is received within current diag response ,Which means [%s]",Actual_Resp_Data[i],Actual_Resp_Data[i+1],Actual_Resp_Data[i+2],meaning);
              //write(BufferString);
            }
          
            if(flag==0)
            {
              BufferString[0]=0;
              snprintf(BufferString,4000,"DTC 0x%02x%02x%02x not Found in last Diag response",DTC3Bytes[0],DTC3Bytes[1],DTC3Bytes[2]);
              testStepFail(BufferString);
            }
            else if (flag == 1)
            {
              BufferString[0]=0;
              snprintf(BufferString,1000,"DTC found but with different mask, expected mask: 0x%02x, Obtained mask: 0x%02x",DTCMask, obtainedMask);
              testStepFail(BufferString);
            }
            else 
            {
              BufferString[0]=0;
              snprintf(BufferString,1000,"DTC 0x%02x%02x%02x found with expected mask: 0x%02x",DTC3Bytes[0],DTC3Bytes[1],DTC3Bytes[2],DTCMask);
              testStepPass(BufferString);
            }
            
          }
    
          break; 
        case 0:
          testStepFail("Response Not Recieved - Timeout");
          break;
        default:
          testStepFail("Response Not Recieved - Internal Error");
          break;  
      }
  }
  else if(value == variant_HBFS)
  {
       switch (testWaitForDiagResponse(Request_HBFS,sendTimeout))
      {
        case 1:
          // check that the expected response is equal to actual response
          Helper_ReportError(diagGetLastResponse(Response_HBFS));
          Helper_ReportError(diagGetPrimitiveData(Response_HBFS , Actual_Resp_Data, 75));
          if(diagGetPrimitiveSize(Response_HBFS)<=3)
          {
            testStepFail("Response Recieved not equal in size of Expected Response");
            //write("test string is %X",Actual_Resp_Data[0]);
          }
          else 
          {
            //write("test string is %X",Actual_Resp_Data[0]);
            for ( i = 3 ;i<diagGetPrimitiveSize(Response_HBFS); i=i+4)
            {
              if(Actual_Resp_Data[i]==DTC3Bytes[0]&&
              Actual_Resp_Data[i+1]==DTC3Bytes[1]&&
              Actual_Resp_Data[i+2]==DTC3Bytes[2])
              {
                flag = 1;
                obtainedMask = Actual_Resp_Data[i+3];
                if(obtainedMask==DTCMask){
                  flag=2;
                  //write("test string is %X",Actual_Resp_Data[0]);
                  //break;
                }
                  
               
              }
              snprintf(BufferString,1000,"check DTC %d%d%d is received within current diag response ,Which means [%s]",Actual_Resp_Data[i],Actual_Resp_Data[i+1],Actual_Resp_Data[i+2],meaning);
              //write(BufferString);
            }
          
            if(flag==0)
            {
              BufferString[0]=0;
              snprintf(BufferString,4000,"DTC 0x%02x%02x%02x not Found in last Diag response",DTC3Bytes[0],DTC3Bytes[1],DTC3Bytes[2]);
              testStepFail(BufferString);
            }
            else if (flag == 1)
            {
              BufferString[0]=0;
              snprintf(BufferString,1000,"DTC found but with different mask, expected mask: 0x%02x, Obtained mask: 0x%02x",DTCMask, obtainedMask);
              testStepFail(BufferString);
            }
            else 
            {
              BufferString[0]=0;
              snprintf(BufferString,1000,"DTC 0x%02x%02x%02x found with expected mask: 0x%02x",DTC3Bytes[0],DTC3Bytes[1],DTC3Bytes[2],DTCMask);
              testStepPass(BufferString);
            }
            
          }
    
          break; 
        case 0:
          testStepFail("Response Not Recieved - Timeout");
          break;
        default:
          testStepFail("Response Not Recieved - Internal Error");
          break;  
      }
    
  }
  
  string_actual[0]=0;
  string_expected[0]=0;
  actual_resp_string[0]=0;
  expected_resp_string[0]=0;
}

void Helper_ReportError_checkDTCObtained_withMask_2(byte DTC3Bytes[], byte DTCMask,dword sendTimeout,char meaning[])
{
  int value;
  int flag;
  byte Actual_Resp_Data[1000];
  char string_actual[1000]="The Actual Response is :";
  char string_expected[1000]="The Expected Response is :";
  char actual_resp_string[1000]="";
  char expected_resp_string[1000]="";
  byte obtainedMask;
  int ResponseCode = 0;
  
  byte Expected_Resp[1000];
  flag=0;

  snprintf(BufferString,1000,"check DTC %d%d%d is received within current diag response ,Which means [%s]",DTC3Bytes[0],DTC3Bytes[1],DTC3Bytes[2],meaning);
  TestExpectation(BufferString);
  
  value = sysGetVariableInt(sysvar::Variant);
  
  
  if(value == variant_FS)
  {
      switch (testWaitForDiagResponse(Request_FS,sendTimeout))
      {
        case 1:
          // check that the expected response is equal to actual response
          Helper_ReportError(diagGetLastResponse(Response_FS));
          Helper_ReportError(diagGetPrimitiveData(Response_FS , Actual_Resp_Data, 75));
          if(diagGetPrimitiveSize(Response_FS)<=3)
          {
            testStepFail("Response Recieved not equal in size of Expected Response");
            //write("test string is %X",Actual_Resp_Data[0]);
          }
          else 
          {
            //write("test string is %X",Actual_Resp_Data[0]);
            for ( i = 3 ;i<diagGetPrimitiveSize(Response_FS); i=i+4)
            {
              if(Actual_Resp_Data[i]==DTC3Bytes[0]&&
              Actual_Resp_Data[i+1]==DTC3Bytes[1]&&
              Actual_Resp_Data[i+2]==DTC3Bytes[2])
              {
                flag = 1;
                obtainedMask = Actual_Resp_Data[i+3];
                if(obtainedMask==DTCMask){
                  flag=2;
                  //write("test string is %X",Actual_Resp_Data[0]);
                  break;
                }
                  
               
              }
              snprintf(BufferString,1000,"check DTC %d%d%d is received within current diag response ,Which means [%s]",Actual_Resp_Data[i],Actual_Resp_Data[i+1],Actual_Resp_Data[i+2],meaning);
              //write(BufferString);
            }
          
            if(flag==0)
            {
              BufferString[0]=0;
              snprintf(BufferString,4000,"DTC 0x%02x%02x%02x not Found in last Diag response",DTC3Bytes[0],DTC3Bytes[1],DTC3Bytes[2]);
              testStepPass(BufferString);
            }
            else if (flag == 1)
            {
              BufferString[0]=0;
              snprintf(BufferString,1000,"DTC found but with different mask, expected mask: 0x%02x, Obtained mask: 0x%02x",DTCMask, obtainedMask);
              testStepPass(BufferString);
            }
            else 
            {
              BufferString[0]=0;
              snprintf(BufferString,1000,"DTC 0x%02x%02x%02x found with expected mask: 0x%02x",DTC3Bytes[0],DTC3Bytes[1],DTC3Bytes[2],DTCMask);
              testStepFail(BufferString);
            }
            
          }
    
          break; 
        case 0:
          testStepFail("Response Not Recieved - Timeout");
          break;
        default:
          testStepFail("Response Not Recieved - Internal Error");
          break;  
      }
    
  }
  else if(value == variant_BFS)
  {
        switch (testWaitForDiagResponse(Request_BFS,sendTimeout))
      {
        case 1:
          // check that the expected response is equal to actual response
          Helper_ReportError(diagGetLastResponse(Response_BFS));
          Helper_ReportError(diagGetPrimitiveData(Response_BFS , Actual_Resp_Data, 75));
          if(diagGetPrimitiveSize(Response_BFS)<=3)
          {
            testStepFail("Response Recieved not equal in size of Expected Response");
            //write("test string is %X",Actual_Resp_Data[0]);
          }
          else 
          {
            //write("test string is %X",Actual_Resp_Data[0]);
            for ( i = 3 ;i<diagGetPrimitiveSize(Response_BFS); i=i+4)
            {
              if(Actual_Resp_Data[i]==DTC3Bytes[0]&&
              Actual_Resp_Data[i+1]==DTC3Bytes[1]&&
              Actual_Resp_Data[i+2]==DTC3Bytes[2])
              {
                flag = 1;
                obtainedMask = Actual_Resp_Data[i+3];
                if(obtainedMask==DTCMask){
                  flag=2;
                  //write("test string is %X",Actual_Resp_Data[0]);
                  break;
                }
                  
               
              }
              snprintf(BufferString,1000,"check DTC %d%d%d is received within current diag response ,Which means [%s]",Actual_Resp_Data[i],Actual_Resp_Data[i+1],Actual_Resp_Data[i+2],meaning);
              //write(BufferString);
            }
          
            if(flag==0)
            {
              BufferString[0]=0;
              snprintf(BufferString,4000,"DTC 0x%02x%02x%02x not Found in last Diag response",DTC3Bytes[0],DTC3Bytes[1],DTC3Bytes[2]);
              testStepPass(BufferString);
            }
            else if (flag == 1)
            {
              BufferString[0]=0;
              snprintf(BufferString,1000,"DTC found but with different mask, expected mask: 0x%02x, Obtained mask: 0x%02x",DTCMask, obtainedMask);
              testStepPass(BufferString);
            }
            else 
            {
              BufferString[0]=0;
              snprintf(BufferString,1000,"DTC 0x%02x%02x%02x found with expected mask: 0x%02x",DTC3Bytes[0],DTC3Bytes[1],DTC3Bytes[2],DTCMask);
              testStepFail(BufferString);
            }
            
          }
    
          break; 
        case 0:
          testStepFail("Response Not Recieved - Timeout");
          break;
        default:
          testStepFail("Response Not Recieved - Internal Error");
          break;  
      }
  }
  else if(value == variant_HFS)
  {
    
      switch (testWaitForDiagResponse(Request_HFS,sendTimeout))
      {
        case 1:
          // check that the expected response is equal to actual response
          Helper_ReportError(diagGetLastResponse(Response_HFS));
          Helper_ReportError(diagGetPrimitiveData(Response_HFS , Actual_Resp_Data, 75));
          if(diagGetPrimitiveSize(Response_HFS)<=3)
          {
            testStepFail("Response Recieved not equal in size of Expected Response");
            //write("test string is %X",Actual_Resp_Data[0]);
          }
          else 
          {
            //write("test string is %X",Actual_Resp_Data[0]);
            for ( i = 3 ;i<diagGetPrimitiveSize(Response_HFS); i=i+4)
            {
              if(Actual_Resp_Data[i]==DTC3Bytes[0]&&
              Actual_Resp_Data[i+1]==DTC3Bytes[1]&&
              Actual_Resp_Data[i+2]==DTC3Bytes[2])
              {
                flag = 1;
                obtainedMask = Actual_Resp_Data[i+3];
                if(obtainedMask==DTCMask){
                  flag=2;
                  //write("test string is %X",Actual_Resp_Data[0]);
                  break;
                }
                  
               
              }
              snprintf(BufferString,1000,"check DTC %d%d%d is received within current diag response ,Which means [%s]",Actual_Resp_Data[i],Actual_Resp_Data[i+1],Actual_Resp_Data[i+2],meaning);
              //write(BufferString);
            }
          
            if(flag==0)
            {
              BufferString[0]=0;
              snprintf(BufferString,4000,"DTC 0x%02x%02x%02x not Found in last Diag response",DTC3Bytes[0],DTC3Bytes[1],DTC3Bytes[2]);
              testStepPass(BufferString);
            }
            else if (flag == 1)
            {
              BufferString[0]=0;
              snprintf(BufferString,1000,"DTC found but with different mask, expected mask: 0x%02x, Obtained mask: 0x%02x",DTCMask, obtainedMask);
              testStepPass(BufferString);
            }
            else 
            {
              BufferString[0]=0;
              snprintf(BufferString,1000,"DTC 0x%02x%02x%02x found with expected mask: 0x%02x",DTC3Bytes[0],DTC3Bytes[1],DTC3Bytes[2],DTCMask);
              testStepFail(BufferString);
            }
            
          }
    
          break; 
        case 0:
          testStepFail("Response Not Recieved - Timeout");
          break;
        default:
          testStepFail("Response Not Recieved - Internal Error");
          break;  
      }
  }
  else if(value == variant_HBFS)
  {
       switch (testWaitForDiagResponse(Request_HBFS,sendTimeout))
      {
        case 1:
          // check that the expected response is equal to actual response
          Helper_ReportError(diagGetLastResponse(Response_HBFS));
          Helper_ReportError(diagGetPrimitiveData(Response_HBFS , Actual_Resp_Data, 75));
          if(diagGetPrimitiveSize(Response_HBFS)<=3)
          {
            testStepFail("Response Recieved not equal in size of Expected Response");
            //write("test string is %X",Actual_Resp_Data[0]);
          }
          else 
          {
            //write("test string is %X",Actual_Resp_Data[0]);
            for ( i = 3 ;i<diagGetPrimitiveSize(Response_HBFS); i=i+4)
            {
              if(Actual_Resp_Data[i]==DTC3Bytes[0]&&
              Actual_Resp_Data[i+1]==DTC3Bytes[1]&&
              Actual_Resp_Data[i+2]==DTC3Bytes[2])
              {
                flag = 1;
                obtainedMask = Actual_Resp_Data[i+3];
                if(obtainedMask==DTCMask){
                  flag=2;
                  //write("test string is %X",Actual_Resp_Data[0]);
                  break;
                }
                  
               
              }
              snprintf(BufferString,1000,"check DTC %d%d%d is received within current diag response ,Which means [%s]",Actual_Resp_Data[i],Actual_Resp_Data[i+1],Actual_Resp_Data[i+2],meaning);
              //write(BufferString);
            }
          
            if(flag==0)
            {
              BufferString[0]=0;
              snprintf(BufferString,4000,"DTC 0x%02x%02x%02x not Found in last Diag response",DTC3Bytes[0],DTC3Bytes[1],DTC3Bytes[2]);
              testStepPass(BufferString);
            }
            else if (flag == 1)
            {
              BufferString[0]=0;
              snprintf(BufferString,1000,"DTC found but with different mask, expected mask: 0x%02x, Obtained mask: 0x%02x",DTCMask, obtainedMask);
              testStepPass(BufferString);
            }
            else 
            {
              BufferString[0]=0;
              snprintf(BufferString,1000,"DTC 0x%02x%02x%02x found with expected mask: 0x%02x",DTC3Bytes[0],DTC3Bytes[1],DTC3Bytes[2],DTCMask);
              testStepFail(BufferString);
            }
            
          }
    
          break; 
        case 0:
          testStepFail("Response Not Recieved - Timeout");
          break;
        default:
          testStepFail("Response Not Recieved - Internal Error");
          break;  
      }
    
  }
  
  string_actual[0]=0;
  string_expected[0]=0;
  actual_resp_string[0]=0;
  expected_resp_string[0]=0;
}

void checkDTCObtained_withMask(byte DTC3Bytes[], byte DTCMask,dword sendTimeout,char meaning[])
{
  Helper_ReportError_checkDTCObtained_withMask(DTC3Bytes,DTCMask,sendTimeout,meaning);
}

void checkDTCObtained_withMask_2(byte DTC3Bytes[], byte DTCMask,dword sendTimeout,char meaning[])
{
  Helper_ReportError_checkDTCObtained_withMask_2(DTC3Bytes,DTCMask,sendTimeout,meaning);
}

 //String to HexArray Converter and return the length
int Convert_String_To_Hex(char MessageData[],byte req[])
{ 
//New  	
  int RequestLength;
  float allBytes;
//OLD
  long data[1000];
  dword pos;
  int i;  
  pos = 0;
  i = 0;
  //New
  allBytes= _ceil(mbstrlen(MessageData)/5.0); //mbstrlen: returns the length of string (array of characters)
  //divide by 5 as request byte contains -> 0x22 ('0'+'x'+'2'+'2'+'space')
  
  RequestLength=(int)(allBytes) ;
  //OLD

  for(i=0; i < RequestLength ;i++){
    //strtol: Converts string to 32 bit integer
    //-> where 'pos' is starting index 
    //-> After the conversion 'pos' will be filled with the next character index after the converted number
    //-> data[i] where the converted number will be placed
    pos = strtol(MessageData, pos, data[i]); 
  }  
  for(i=0; i < RequestLength ;i++){
    req[i] = (byte) data[i];
    //write("data %X",data[i]);
  }
  
  //write("%d",RequestLength);
  return RequestLength;

}

//TestWaitForTimeout with Comment/Justification 
Pause(long Timeout, char comment[]){
	char buffer[500];
	snprintf(buffer,500,"Wait [%d] ms as [%s]",Timeout,comment);
	TestAction(buffer);
	TestWaitForTimeout(Timeout);
}




