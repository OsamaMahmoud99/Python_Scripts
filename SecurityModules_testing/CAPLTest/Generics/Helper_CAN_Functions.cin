/*@!Encoding:1252*/
includes
{
}

variables
{
  int Confirmation;
  int NMCount = 0, AppCount = 0;
  int check;

  // measure at which time the message recieved
  float timer_NM[22];
  int timer_NMCount = 0;
  float timer_APP[10];
  int timer_APPCount = 0;
  
}


Reset(Void){
  Power_Supply_SelectChannel (1) ;
  testWaitForTimeout(500);
 Power_Supply_Volt_Set(0.1);
  //testWaitForTimeout(1000);
  Power_Supply_SelectChannel (2) ;
  testWaitForTimeout(500);
 Power_Supply_Volt_Set(0.1);  
  
  testWaitForTimeout(5000);
  Power_Supply_SelectChannel (1) ;
  testWaitForTimeout(500);
 Power_Supply_Volt_Set(12.0);
  //testWaitForTimeout(1000);
  Power_Supply_SelectChannel (2) ;
  testWaitForTimeout(500);
 Power_Supply_Volt_Set(12.0);
}



Start_Frame(char msg1[])
{
  int Confirmation=-1;
  
  snprintf(string, 200,"Start Sending Message %s", msg1);
  TestAction(string);
  Confirmation=TestEnableMsg (msg1);
  if(Confirmation != -1)
	{
		TestStepPass("Frame started");
    AssertPass("Frame started");
	}
	else
	{
		TestStepFail("Frame Not started");
    AssertFail("Frame Not started");
	}
//  testWaitForTimeout(1000);
}


Stop_Frame(char msg1[])
{
  int Confirmation=-1;
  snprintf(string, 200,"Stop Sending Message %s", msg1);
  TestAction(string);
  Confirmation=TestDisableMsg (msg1);
  if(Confirmation != -1)
	{
		TestStepPass("Frame stopped");
    AssertPass("Frame stopped");
	}
	else
	{
		TestStepFail("Frame Not stopped");
    AssertFail("Frame Not stopped");
	}
//  testWaitForTimeout(1000);
}

Start_all_Frames_from_Node(char Node[])
{
  int Confirmation=-1;
  
  snprintf(string, 200,"Start Sending Messages from Node: [%s]", Node);
  TestAction(string);
  Confirmation=TestEnableMsgAllTx(Node);
  if(Confirmation != -1)
	{
		TestStepPass("Frames started");
    AssertPass("Frames started");
	}
	else
	{
		TestStepFail("Frames Not started");
    AssertFail("Frames Not started");
	}
  //testWaitForTimeout(1000);
}

Stop_all_Frames_from_Node(char Node[])
{
  int Confirmation=-1;
  
  snprintf(string, 200,"Stop Sending Messages from Node: [%s]", Node);
  TestAction(string);
  Confirmation=TestDisableMsgAllTx(Node);
  if(Confirmation != -1)
	{
		TestStepPass("Frames started");
    AssertPass("Frames started");
	}
	else
	{
		TestStepFail("Frames Not started");
    AssertFail("Frames Not started");
	}
  //testWaitForTimeout(1000);
}

void Start_all_Frames(){
  TestAction("Start Sending All Frames");
  Start_all_Frames_from_Node("ADCAM");
  Start_all_Frames_from_Node("AGSM");
  Start_all_Frames_from_Node("BCM");
  Start_all_Frames_from_Node("BSM");
  //Start_all_Frames_from_Node("DMSM");
  Start_all_Frames_from_Node("ESL");
  Start_all_Frames_from_Node("EVCU2");
  Start_all_Frames_from_Node("GNMM");
  Start_all_Frames_from_Node("IPC");
  Start_all_Frames_from_Node("MPAD");
  Start_all_Frames_from_Node("RFHM");
  Start_all_Frames_from_Node("SGW");
}

void Stop_all_Frames(){
  TestAction("Stop All Frames");
  Stop_all_Frames_from_Node("ADCAM");
  Stop_all_Frames_from_Node("AGSM");
  Stop_all_Frames_from_Node("BCM");
  Stop_all_Frames_from_Node("BSM");
  //Stop_all_Frames_from_Node("DMSM");
  Stop_all_Frames_from_Node("ESL");
  Stop_all_Frames_from_Node("EVCU2");
  Stop_all_Frames_from_Node("GNMM");
  Stop_all_Frames_from_Node("IPC");
  Stop_all_Frames_from_Node("MPAD");
  Stop_all_Frames_from_Node("RFHM");
  Stop_all_Frames_from_Node("SGW");
}

void check_BUS_Load_more_than(int usage_percentage,int CAN_Channel){
  int actual_value;
  snprintf(string,400,"Check That Bus Load of channel [%d] is more than [%d]",CAN_Channel,usage_percentage);
  TestExpectation(string);
  actual_value=canGetBusLoad(CAN_Channel);
  if(actual_value>usage_percentage){
    snprintf(string,400,"The Bus Load of CAN BUS channel [%d] is [%d] which is more than [%d]",CAN_Channel,actual_value,usage_percentage);
    testStepPass(string);
    AssertPass(string);
  }
  else{
    snprintf(string,400,"The Bus Load of CAN BUS channel [%d] is [%d] which is less than [%d]",CAN_Channel,actual_value,usage_percentage);
    testStepFail(string);
    AssertFail(string);
  }
  
}

void check_BUS_Load_less_than(int usage_percentage,int CAN_Channel){
  int actual_value;
  snprintf(string,400,"Check That Bus Load of channel [%d] is more than [%d]",CAN_Channel,usage_percentage);
  TestExpectation(string);
  actual_value=canGetBusLoad(CAN_Channel);
  if(actual_value<usage_percentage){
    snprintf(string,400,"The Bus Load of CAN BUS channel [%d] is [%d] which is less than [%d]",CAN_Channel,actual_value,usage_percentage);
    testStepPass(string);
    AssertPass(string);
  }
  else{
    snprintf(string,400,"The Bus Load of CAN BUS channel [%d] is [%d] which is more than [%d]",CAN_Channel,actual_value,usage_percentage);
    testStepFail(string);
    AssertFail(string);
  }
  
}

Check_Msg_Received(char msg1[],int window)
{   
    dword a;
    a=getMessageID(msg1);
  	Confirmation = -1;
	  Confirmation = TestWaitForMessage(a, window);
    snprintf(string,400,"Check Message %s Recieved within %d ms",msg1,window);
    TestExpectation(string);

	
	if(Confirmation == 1)
	{
		TestStepPass("Frame Recieved");
    AssertPass("Frame Recieved");
	}
	else
	{
		TestStepFail("Frame Not Received");
    AssertFail("Frame Not Received");
	}
}

Check_Msg_NOT_Received(char msg1[],int window)
{
  dword a;
  a=getMessageID(msg1);
  Confirmation = -1;
  Confirmation = TestWaitForMessage(a,window);
  snprintf(string,400,"Check Message %s NOT Recieved within %d ms",msg1,window);
  TestExpectation(string);

	
	if(Confirmation == 1) 
	{
		TestStepFail("Frame Received");	
    AssertFail("Frame Received");	
	}
	else
	{
	  TestStepPass("Frame not Recieved");
    AssertPass("Frame not Recieved");
 	}
  
}

Check_PDU_Received(char msg1[],int window)
{   
    dword a;
//    a=getMessageID(msg1);
  	Confirmation = -1;
	  Confirmation = TestWaitForPDU(msg1,0, window);
    snprintf(string,400,"Check Message %s Recieved within %d ms",msg1,window);
    TestExpectation(string);

	
	if(Confirmation == 1)
	{
		TestStepPass("Frame Recieved");
    AssertPass("Frame Recieved");
	}
	else
	{
		TestStepFail("Frame Not Received");
    AssertFail("Frame Not Received");
	}
}

Check_PDU_NOT_Received(char msg1[],int window)
{
  dword a;
  //a=getMessageID(msg1);
  Confirmation = -1;
  Confirmation = TestWaitForPDU(msg1,0,window);
  snprintf(string,400,"Check Message %s NOT Recieved within %d ms",msg1,window);
  TestExpectation(string);

	
	if(Confirmation != 0) 
	{
		TestStepFail("Check_PDU_NOT_Received","Frame Received or General error %d",Confirmation);	
    AssertFail("Frame Received");	
	}
	else
	{
	  TestStepPass("Frame not Recieved");
    AssertPass("Frame not Recieved");
 	}
  
}
//void Start_Test_Msg_Recieved(dbMsg* msg){
//  snprintf(string,400,"Start Checking That Message %s is being Recieved",msg);
//  TestExpectation(string);
//  check = ChkStart_MsgAbsCycleTimeViolation (msg,900,1100);
//  TestAddCondition(check);
//  
//}
//
//void Stop_Test_Msg_Recieved(){
//  snprintf(string,400,"Stop Checking That Message %s is being Recieved");
//  TestExpectation(string);
//  TestRemoveCondition(check);
//}

Check_SignalWithValue(signal *buffer,int a, char meaning[])
{
int result=0;
snprintf(string,400,"Check Signal %s value = %d",buffer.name,a);
TestExpectation(string);

result = getSignal(buffer);
if(result == a){
  snprintf(string,400,"CheckSignal:  %s ,Expected = %d,Obtained Right value = %d, which means %s",buffer.name,a,result,meaning);
  TestStepPass("CheckSignal"," Signal %s ,Expected = %d,Obtained Right value = %d, which means %s",buffer.name,a,result,meaning);
  AssertPass(string);
}
else{
  snprintf(string,400,"CheckSignal:  %s ,Expected = %d,Obtained Wrong- value = %d, which means %s",buffer.name,a,result,meaning);
  testStepfail("CheckSignal"," Signal %s ,Expected = %d,Obtained Wrong- value = %d, which means %s",buffer.name,a,result,meaning);
  AssertFail(string);
}
}

Check_SignalWithValuewithin(signal *buffer,int value, int timeout, char comment[])
{
  int result=0;
  dword index = 0;
  int obtained = 0;
  char container[800];
  result = TestJoinSignalMatch(buffer,value);
  index = TestWaitForAllJoinedEvents(timeout);
  obtained =  getSignal(buffer);
  snprintf(container,800,"Check value of: [%s]",buffer.name);
  TestAction(container);
  snprintf(container,800,"Check value of: [%s] is equal to: [%d] which means [%s]",buffer.name,value,comment);
  write(container);
  TestExpectation(container);
  if(index > 0)
  {
	testStepPass("CheckSignal"," Signal %s ,Expected = %d,Obtained Right value = %d",buffer.name,value,obtained);
	AssertPass(" Signal  ,Expected = ,Obtained Right value = ");
  }
  else
  {
    testStepfail("CheckSignal"," Signal %s ,Expected = %d,Obtained Wrong- value = %d",buffer.name,value,obtained);
	//AssertFail(" Signal  ,Expected = ,Obtained Wrong- value = ");
  }
}


setSignalwithValue(Signal *buf,double b,char meaning[])
{
  snprintf(string,400,"Set the value of signal %s with value %f ,which means %s",buf.name,b,meaning);
  TestAction(string);
  setSignal(buf,b); 
}

checkDLCMessage(message* msg1,int expectedDLC){
	long currentDLC;
  char container[800];
  currentDLC = canGetDataLength(msg1);
  snprintf(container,800,"Check DLC of message [%s] is: [%d] ",msg1.name,expectedDLC);
  TestExpectation(container);
  if (currentDLC == expectedDLC){
    testStepPass("CheckSignal","Expected = %d,Obtained Right value = %d",expectedDLC,currentDLC);
    snprintf(container,800,"CheckSignal","Expected = %d,Obtained Right value = %d",expectedDLC,currentDLC);
    AssertPass(container);
    }
  else{
    snprintf(container,800,"CheckSignal","Expected = %d,Obtained Right value = %d",expectedDLC,currentDLC);
    AssertFail(container);
    testStepFail("CheckSignal","Expected = %d,Obtained Right value = %d",expectedDLC,currentDLC);
  }
}

checkMessages()
{
  long index=0,check1=0,check2=0;
  long Res;
  int64 mEventTime;
  //testWaitForMessage(CAN1::NMH_MIK,2000);
  //check1=(long) TestJoinMessageEvent(CAN1::NMH_MIK);
  //check2=(long) TestJoinMessageEvent(CAN1::KN_MIK);
TestJoinTextEvent("ErrorFrame occurred!");

index = TestWaitForAnyJoinedEvent(500);
  write("Obtained EVENT %d, Check1:%d, Check2:%d",index,check1,check2);
  Res = testGetJoinedEventOccured(index, mEventTime);
      write("mEventTime = %I64d ; Res = %ld ; lReturn = %ld",mEventTime,Res,index);
  
//  Res = testGetJoinedEventOccured(index, check1);
}
check_msg_cycle_time (dbMsg* msg, int min_periodicity,int max_periodicity, int Timeout){
  //canGetDataLength(msg);
	char buffer[300];
	snprintf(buffer,300,"Check message [%s] is received cyclically with average periodicity [%d] ms for %d ms",DBLookup(msg).Name,min_periodicity/2+max_periodicity/2,Timeout);
	TestAction(buffer);
	check = ChkStart_MsgAbsCycleTimeViolation (msg,min_periodicity,max_periodicity);
	TestAddCondition(check);
	TestWaitForTimeout(Timeout);
	TestRemoveCondition(check);
}
check_signal_value_change (signal *buffer,int Timeout){
  char buffer2[300];
  snprintf(buffer2,300,"Check if the value of signal [%s] is changed within [%d] ms",buffer.name,Timeout);
  TestAction(buffer2);
  write("%s",buffer2);
	check = ChkStart_SignalValueChange (buffer);
	TestAddCondition(check);
	TestWaitForTimeout(Timeout);
	TestRemoveCondition(check);
}

check_msg_max_occurrence (dbMsg* msg, int max_count,int Timeout){
	// checks that the message is sent less than 3 times
	check = ChkStart_MsgOccurrenceCount (msg,max_count);
	TestAddCondition(check);
	// sequence of different actions and waiting conditions
	TestWaitForTimeout(Timeout);
	TestRemoveCondition(check);
}

send_NM_frame_once (message* NMmessage){
  output(NMmessage);
}

/*check_first_frame_is_NM(){
	NMCount = 0; AppCount = 0;	
  testWaitForMessage(NMH_MIK,10000);
  if(NMCount > AppCount){
    testStepPass( "First Frame received is NMH_MIK");
  }
  else{
    testStepFail( "First Frame received is KN_MIK");
  }
}

check_first_frame_is_APP(){
  testWaitForMessage(KN_MIK,10000);
  if(NMCount < AppCount){
    testStepPass( "First Frame received is KN_MIK");
  }
  else{
    testStepFail( "First Frame received is NMH_MIK");
  }
}
*/
/*
check_NM_APP_emission(int NMStatus, int AppStatus, int Timeout){
  int NMH_minPERIODICITY = 180, APP_minPERIODICITY = 450;
  int NMH_maxPERIODICITY = 220, APP_maxPERIODICITY = 550;
  int NM_Expected = 0, APP_Expected = 0;
  NMCount = 0;     AppCount = 0;
  timer_NMCount = 0;  timer_APPCount = 0;
  
  //testStep("","========================================================================================================");
  testStep("","-------------------------------------------------------------- Check NM and APP emission within %d ms -----------------------------------------------------------",Timeout);
  //testStep("","========================================================================================================");
  TestWaitForTimeout__(Timeout,"Timeout");
  //testStep("","========================================================================================================");
  testStep("","------------------ Messages Statistics ------------------");
  //testStep("","========================================================================================================");
  testStep("","------------------- NM Timestamp ----------------------");
  testStep("NM","[01st: %f] --- [02nd: %f] --- [03rd: %f] --- [04th: %f] --- [05th: %f]\n  [06th: %f] --- [07th: %f] --- [08th: %f] --- [09th: %f] --- [10th: %f] \n [11th: %f] --- [12th: %f] --- [13th: %f] --- [14th: %f] --- [15th: %f] \n [16th: %f] --- [17th: %f] --- [18th: %f] --- [19th: %f] --- [20th: %f] \n [21st: %f] --- [22nd: %f]",timer_NM[0],timer_NM[1],timer_NM[2],timer_NM[3],timer_NM[4],timer_NM[5],timer_NM[6],timer_NM[7],timer_NM[8],timer_NM[9],timer_NM[10],timer_NM[11],timer_NM[12],timer_NM[13],timer_NM[14],timer_NM[15],timer_NM[16],timer_NM[17],timer_NM[18],timer_NM[19],timer_NM[20],timer_NM[21]);
  testStep("","------------------- APP Timestamp ---------------------");
  testStep("APP","[01st: %f] --- [02nd: %f] --- [03rd: %f] --- [04th: %f] --- [05th: %f]\n  [06th: %f] --- [07th: %f] --- [08th: %f]",timer_APP[0],timer_APP[1],timer_APP[2],timer_APP[3],timer_APP[4],timer_APP[5],timer_APP[6],timer_APP[7]);
  
  if(NMStatus == 0 && AppStatus == 0){
    NM_Expected = 0; APP_Expected = 0;
    if(NMCount == 0 && AppCount == 0){
      testStepPass("","NM message within %d ms\n Expected: %d messages\n Obtained: %d messages\n APP message within %d ms\n Expected: %d messages\n Obtained: %d messages ",Timeout,NM_Expected,NMCount,Timeout,APP_Expected,AppCount);
    }
    else{
      testStepFail("","NM message within %d ms\n Expected: %d messages\n Obtained: %d messages\n APP message within %d ms\n Expected: %d messages\n Obtained: %d messages ",Timeout,NM_Expected,NMCount,Timeout,APP_Expected,AppCount);
    }
  }
  else if(NMStatus == 1 && AppStatus == 1){
    if(NMCount >= Timeout/NMH_maxPERIODICITY && AppCount >= Timeout/APP_maxPERIODICITY){
      testStepPass("","NM message within %d ms\n ----------------\n Expected: %d - %d messages\n Obtained: %d messages\n \nAPP message within %d ms \n ---------------- \n Expected: %d - %d messages\n Obtained: %d messages ",Timeout,Timeout/NMH_maxPERIODICITY,Timeout/NMH_minPERIODICITY,NMCount,Timeout,Timeout/APP_maxPERIODICITY,Timeout/APP_minPERIODICITY,AppCount);
    }
    else{
      testStepFail("","NM message within %d ms\n ----------------\n Expected: %d - %d messages\n Obtained: %d messages\n \nAPP message within %d ms \n ---------------- \n Expected: %d - %d messages\n Obtained: %d messages ",Timeout,Timeout/NMH_maxPERIODICITY,Timeout/NMH_minPERIODICITY,NMCount,Timeout,Timeout/APP_maxPERIODICITY,Timeout/APP_minPERIODICITY,AppCount);
    }  
  }
  else if(NMStatus == 0 && AppStatus == 1){
    NM_Expected = 0;
    if(NMCount == 0 && AppCount >= Timeout/APP_maxPERIODICITY){
      testStepPass("","NM message within %d ms\n ----------------\n Expected: %d messages\n Obtained: %d messages\n \nAPP message within %d ms \n ---------------- \n Expected: %d - %d messages\n Obtained: %d messages ",Timeout,NM_Expected,NMCount,Timeout,Timeout/APP_maxPERIODICITY,Timeout/APP_minPERIODICITY,AppCount);
    }
    else{
      testStepFail("","NM message within %d ms\n ----------------\n Expected: %d messages\n Obtained: %d messages\n \nAPP message within %d ms \n ---------------- \n Expected: %d - %d messages\n Obtained: %d messages ",Timeout,NM_Expected,NMCount,Timeout,Timeout/APP_maxPERIODICITY,Timeout/APP_minPERIODICITY,AppCount);
    }
  }
   else if(NMStatus == 1 && AppStatus == 0){
    APP_Expected = 0;
    if(NMCount >= Timeout/NMH_maxPERIODICITY && AppCount == 0){
      testStepPass("","NM message within %d ms\n ----------------\n Expected: %d - %d messages\n Obtained: %d messages\n \nAPP message within %d ms \n ---------------- \n Expected: %d messages \n Obtained: %d messages ",Timeout,Timeout/NMH_minPERIODICITY,Timeout/NMH_maxPERIODICITY,NMCount,Timeout,APP_Expected,AppCount);
    }
    else{
      testStepFail("","NM message within %d ms\n ----------------\n Expected: %d - %d messages\n Obtained: %d messages\n \nAPP message within %d ms \n ---------------- \n Expected: %d messages\n Obtained: %d messages ",Timeout,Timeout/NMH_minPERIODICITY,Timeout/NMH_maxPERIODICITY,NMCount,Timeout,APP_Expected,AppCount);
    }
  }
}
*/

void Start_Test_Comm_On(){
 TestAction("Start Checking that Communication is working");
  check = ChkStart_MsgAbsCycleTimeViolation (SWSP_STEERING_WHEEL_Container_ST3_DAP_StWhl_Ctrl_ST3     ,1000,1000);
  TestAddCondition(check);
  
}

void Stop_Test_Comm_On(){
 TestAction("Stop Checking that Communication is working");
  TestRemoveCondition(check);
}

