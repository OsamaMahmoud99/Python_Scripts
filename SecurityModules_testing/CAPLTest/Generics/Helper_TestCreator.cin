/*@!Encoding:1252*/
includes
{

}

variables
{
  dword handle=0;
  char filePath[255] = "C:\\Workset\\VOLVO\\SPA2\\Project Initiation\\RBS\\RBS\\RBS_CANFD\\ValidationTests";
  char filename[100] = "extractedTests_1.txt";
}


on preStart
{
  //uncomment the following line if you are not using VN8900
  //setWritePath(filePath);
  InitTestsExtract();
}

void InitTestsExtract()
{
  char initText[5]= "";
  
  OverwriteFile(initText);
}

void OverwriteFile(char text[])
{
  handle= openFileWrite(filename,1);
  
  filePutString(text, 20000, handle); 
  
  fileClose(handle); 
}